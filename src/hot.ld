/* The code fresh conversions run, grouped before .text so that they fault in fewer pages.
   Generated by tools/hot_sections.py; regenerate it with that script, never by hand.
   Names that no longer exist match nothing. */
SECTIONS
{
  .text.hot :
  {
    *(.text.startup.main)
    *libstdc++.a:system_error.o(.text.startup._GLOBAL__sub_I_system_error.cc)
    *libgcc.a:cpuinfo.o(.text.startup)
    *crtbeginS.o(.text)
    *(.text._ZNSt7__cxx1112basic_stringIcSt11char_traitsIcESaIcEE12_M_constructIPcEEvT_S7_St20forward_iterator_tag.isra.0)
    *(.text._ZN12_GLOBAL__N_110StartsWithESt17basic_string_viewIcSt11char_traitsIcEES3_)
    *(.text._ZN12_GLOBAL__N_117ChooseImageTargetERKNSt7__cxx1112basic_stringIcSt11char_traitsIcESaIcEEERKN7RayoPdf3Api15DocumentOptionsERNS8_6Layout14ConvertOptionsE)
    *(.text._ZN12_GLOBAL__N_113ConvertSourceERKNSt7__cxx1112basic_stringIcSt11char_traitsIcESaIcEEES7_St17basic_string_viewIcS3_ERKN7RayoPdf6Layout14ConvertOptionsERS5_RNSA_5Batch6RecordEbRNS_6SourceEPS5_)
    *(.text._ZN7RayoPdf5Batch6RecordC2Ev)
    *(.text._ZN7RayoPdf5Batch6RecordD2Ev)
    *(.text._ZN7RayoPdf6Layout14ConvertOptionsC2ERKS1_)
    *(.text._ZSteqIcSt11char_traitsIcESaIcEEbRKNSt7__cxx1112basic_stringIT_T0_T1_EEPKS5_)
    *(.text._ZNSt7__cxx1112basic_stringIcSt11char_traitsIcESaIcEEC2IS3_EEPKcRKS3_)
    *(.text._ZSteqIcSt11char_traitsIcEEbSt17basic_string_viewIT_T0_ENSt15__type_identityIS5_E4typeE)
    *librayopdf_api.a:convert.cpp.o(.text._ZN7RayoPdf3Api9ReadInputERKNSt7__cxx1112basic_stringIcSt11char_traitsIcESaIcEEERNS_4File9InputFileERS6_PS6_)
    *librayopdf_api.a:convert.cpp.o(.text._ZN7RayoPdf3Api12OpenDocumentERKNSt7__cxx1112basic_stringIcSt11char_traitsIcESaIcEEESt17basic_string_viewIcS4_ESA_RSt10unique_ptrINS_8DocumentESt14default_deleteISC_EERS6_)
    *librayopdf_api.a:flags.cpp.o(.text._ZN7RayoPdf3Api12_GLOBAL__N_110StartsWithESt17basic_string_viewIcSt11char_traitsIcEES5_)
    *librayopdf_api.a:flags.cpp.o(.text._ZN7RayoPdf3Api17ParseDocumentFlagESt17basic_string_viewIcSt11char_traitsIcEERNS0_15DocumentOptionsERNSt7__cxx1112basic_stringIcS3_SaIcEEE)
    *librayopdf_layout.a:convert.cpp.o(.text._ZN7RayoPdf6Layout12_GLOBAL__N_113DocumentParts4ReadEPv)
    *librayopdf_layout.a:convert.cpp.o(.text._ZNSt6vectorIN7RayoPdf6Layout15PageTextQualityESaIS2_EE17_M_default_appendEm)
    *librayopdf_layout.a:convert.cpp.o(.text._ZNSt6vectorIN7RayoPdf6Layout9PageRouteESaIS2_EE17_M_default_appendEm)
    *librayopdf_layout.a:convert.cpp.o(.text._ZNSt6vectorIN7RayoPdf6Layout8PageDataESaIS2_EE17_M_default_appendEm)
    *librayopdf_layout.a:convert.cpp.o(.text._ZN7RayoPdf6Layout12_GLOBAL__N_115ConvertDocumentERKNS_8DocumentERKNS0_14ConvertOptionsERNSt7__cxx1112basic_stringIcSt11char_traitsIcESaIcEEERNS0_13ConvertReportE)
    *librayopdf_layout.a:convert.cpp.o(.text._ZN7RayoPdf6Layout7ConvertERKNS_8DocumentERKNS0_14ConvertOptionsERNSt7__cxx1112basic_stringIcSt11char_traitsIcESaIcEEERNS0_13ConvertReportE)
    *librayopdf_layout.a:exact.cpp.o(.text._ZN7RayoPdf6Layout15FindExactSourceERKNS_8DocumentERSt17basic_string_viewIcSt11char_traitsIcEE)
    *librayopdf_layout.a:exact.cpp.o(.text._ZNSt6vectorIjSaIjEE17_M_realloc_insertIJRKjEEEvN9__gnu_cxx17__normal_iteratorIPjS1_EEDpOT_)
    *librayopdf_layout.a:interpreter.cpp.o(.text._ZN7RayoPdf6Layout12_GLOBAL__N_18MultiplyERKNS1_6MatrixES4_)
    *librayopdf_layout.a:interpreter.cpp.o(.text._ZNSt5dequeINSt7__cxx1112basic_stringIcSt11char_traitsIcESaIcEEESaIS5_EE19_M_destroy_data_auxESt15_Deque_iteratorIS5_RS5_PS5_ESB_.isra.0)
    *librayopdf_layout.a:interpreter.cpp.o(.text._ZNSt6vectorIN7RayoPdf6Layout5GlyphENS1_14UnsetAllocatorIS2_EEE17_M_default_appendEm)
    *librayopdf_layout.a:interpreter.cpp.o(.text._ZNSt6vectorIPKN7RayoPdf4Text4FontESaIS4_EE17_M_realloc_insertIJS4_EEEvN9__gnu_cxx17__normal_iteratorIPS4_S6_EEDpOT_)
    *librayopdf_layout.a:interpreter.cpp.o(.text._ZNSt6vectorIhSaIhEE17_M_realloc_insertIJhEEEvN9__gnu_cxx17__normal_iteratorIPhS1_EEDpOT_)
    *librayopdf_layout.a:interpreter.cpp.o(.text._ZN7RayoPdf6Layout12_GLOBAL__N_111Interpreter12SetFontEntryERKNS_8PdfValueEd)
    *librayopdf_layout.a:interpreter.cpp.o(.text._ZN7RayoPdf6Layout11ReadOutlineERKNS_8DocumentERSt6vectorINS0_12OutlineEntryESaIS5_EE)
    *librayopdf_layout.a:interpreter.cpp.o(.text._ZN7RayoPdf6Layout12_GLOBAL__N_111Interpreter8ShowTextEPKNS_8PdfValueEmSt17basic_string_viewIcSt11char_traitsIcEE)
    *librayopdf_layout.a:interpreter.cpp.o(.text._ZN7RayoPdf6Layout12_GLOBAL__N_111Interpreter7ExecuteENS1_2OpERKNS_12ContentLexerERKNS_8PdfValueEi)
    *librayopdf_layout.a:interpreter.cpp.o(.text._ZN7RayoPdf6Layout12_GLOBAL__N_111Interpreter9RunStreamESt17basic_string_viewIcSt11char_traitsIcEERKNS_8PdfValueEi)
    *librayopdf_layout.a:interpreter.cpp.o(.text._ZN7RayoPdf6Layout13InterpretPageERKNS_8DocumentERNS_4Text9FontCacheEibRNS0_8PageDataERNS0_9PageStatsE)
    *librayopdf_layout.a:math.cpp.o(.text._ZN7RayoPdf6Layout10MathFontOfESt17basic_string_viewIcSt11char_traitsIcEE)
    *librayopdf_layout.a:math.cpp.o(.text._ZN7RayoPdf6Layout12MathFontByteESt17basic_string_viewIcSt11char_traitsIcEE)
    *librayopdf_layout.a:math.cpp.o(.text._ZNSt6vectorIjSaIjEE17_M_default_appendEm)
    *librayopdf_layout.a:math.cpp.o(.text._ZNSt6vectorIhSaIhEE14_M_fill_assignEmRKh)
    *librayopdf_layout.a:math.cpp.o(.text._ZNSt6vectorImSaImEE17_M_realloc_insertIJRKmEEEvN9__gnu_cxx17__normal_iteratorIPmS1_EEDpOT_)
    *librayopdf_layout.a:math.cpp.o(.text._ZNSt6vectorIjSaIjEE14_M_fill_assignEmRKj)
    *librayopdf_layout.a:ocr.cpp.o(.text._ZN7RayoPdf6Layout9RoutePageERKNS0_8PageDataERKNS0_15PageTextQualityENS0_7OcrModeERNS0_9PageRouteE)
    *librayopdf_layout.a:ocr.cpp.o(.text._ZNSt6vectorIjSaIjEE17_M_realloc_insertIJjEEEvN9__gnu_cxx17__normal_iteratorIPjS1_EEDpOT_)
    *librayopdf_layout.a:ocr.cpp.o(.text._ZN7RayoPdf6Layout14RecognisePagesERKNS_8DocumentERNS_4Text9FontCacheERKNS0_10OcrOptionsERSt6vectorINS0_8PageDataESaISB_EERSA_INS0_15PageTextQualityESaISF_EERKSA_INS0_9PageRouteESaISJ_EERNS0_13ConvertReportEb)
    *librayopdf_layout.a:ocr_route.cpp.o(.text._ZN7RayoPdf6Layout11MeasurePageERKNS0_8PageDataEmmRNS0_11PageSignalsE)
    *librayopdf_layout.a:ocr_route.cpp.o(.text._ZN7RayoPdf6Layout8PlanPageERKNS0_8PageDataERKNS0_11PageSignalsENS0_7OcrModeERNS0_7OcrPlanE)
    *librayopdf_layout.a:pipeline.cpp.o(.text._ZN7RayoPdf6Layout12ConvertPagesERSt6vectorINS0_8PageDataESaIS2_EERKS1_INS0_15PageTextQualityESaIS6_EERKS1_INS0_12OutlineEntryESaISB_EEbRNSt7__cxx1112basic_stringIcSt11char_traitsIcESaIcEEERNS0_13ConvertReportEPKNS0_11ImageOutputEPKNS0_9StructureENS0_8MathModeEPNS0_8PagePoolEPKNS0_12DocumentReadEPKNS0_14OutputSettingsE)
    *librayopdf_layout.a:reading_order.cpp.o(.text._ZN7RayoPdf9PerThreadINS_6Layout12_GLOBAL__N_19CutLevelsEEERT_v.part.0)
    *librayopdf_layout.a:reading_order.cpp.o(.text._ZN7RayoPdf6Layout19ReleaseOrderScratchEv)
    *librayopdf_layout.a:semantics.cpp.o(.text._ZN7RayoPdf6Layout12_GLOBAL__N_114FirstCodePointESt17basic_string_viewIcSt11char_traitsIcEE)
    *librayopdf_layout.a:semantics.cpp.o(.text._ZN7RayoPdf6Layout12_GLOBAL__N_17IsLowerEj)
    *librayopdf_layout.a:semantics.cpp.o(.text._ZN7RayoPdf6Layout12_GLOBAL__N_19ContinuesERKNS1_8RawBlockERKNS1_4InfoES7_S7_bf.part.0)
    *librayopdf_layout.a:semantics.cpp.o(.text._ZN7RayoPdf6Layout12_GLOBAL__N_111WideLeadingERKSt6vectorINS1_4InfoESaIS3_EEf.isra.0)
    *librayopdf_layout.a:semantics.cpp.o(.text._ZSt16__introsort_loopIN9__gnu_cxx17__normal_iteratorIPjSt6vectorIjSaIjEEEElNS0_5__ops15_Iter_comp_iterIZN7RayoPdf6Layout11BuildBlocksERKS3_INSA_8PageDataESaISB_EERKS3_INSA_12OutlineEntryESaISG_EERKS3_IhSaIhEEbRNSA_9BlockListEEUljjE_EEEvT_ST_T0_T1_)
    *librayopdf_layout.a:semantics.cpp.o(.text._ZNSt6vectorIN7RayoPdf6Layout9BlockLineESaIS2_EE15_M_range_insertIN9__gnu_cxx17__normal_iteratorIPS2_S4_EEEEvS9_T_SA_St20forward_iterator_tag.isra.0)
    *librayopdf_layout.a:semantics.cpp.o(.text._ZNSt6vectorIN7RayoPdf6Layout12_GLOBAL__N_18RawBlockESaIS3_EE17_M_realloc_insertIJRKS3_EEEvN9__gnu_cxx17__normal_iteratorIPS3_S5_EEDpOT_)
    *librayopdf_layout.a:semantics.cpp.o(.text._ZSt16__insertion_sortIN9__gnu_cxx17__normal_iteratorIPjSt6vectorIjSaIjEEEENS0_5__ops15_Iter_comp_iterIZN7RayoPdf6Layout11BuildBlocksERKS3_INSA_8PageDataESaISB_EERKS3_INSA_12OutlineEntryESaISG_EERKS3_IhSaIhEEbRNSA_9BlockListEEUljjE_EEEvT_ST_T0_)
    *librayopdf_layout.a:semantics.cpp.o(.text._ZN7RayoPdf6Layout12_GLOBAL__N_113LastCodePointESt17basic_string_viewIcSt11char_traitsIcEE)
    *librayopdf_layout.a:semantics.cpp.o(.text._ZN7RayoPdf6Layout12_GLOBAL__N_113MoveAddressesERKSt6vectorINS0_8PageDataESaIS3_EERS2_INS0_5BlockESaIS8_EERS2_INS0_9BlockLineESaISC_EE)
    *librayopdf_layout.a:semantics.cpp.o(.text._ZN7RayoPdf6Layout12_GLOBAL__N_18LineInfoERKNS0_8PageDataEjjRNS1_5MarksERNS1_4InfoERNSt7__cxx1112basic_stringIcSt11char_traitsIcESaIcEEERmSG_)
    *librayopdf_layout.a:semantics.cpp.o(.text._ZNSt10_HashtableIjSt4pairIKjSt6vectorIjSaIjEEESaIS5_ENSt8__detail10_Select1stESt8equal_toIjESt4hashIjENS7_18_Mod_range_hashingENS7_20_Default_ranged_hashENS7_20_Prime_rehash_policyENS7_17_Hashtable_traitsILb0ELb0ELb1EEEED2Ev)
    *librayopdf_layout.a:semantics.cpp.o(.text._ZNSt6vectorIN7RayoPdf6Layout9BlockLineESaIS2_EE17_M_realloc_insertIJRKS2_EEEvN9__gnu_cxx17__normal_iteratorIPS2_S4_EEDpOT_)
    *librayopdf_layout.a:semantics.cpp.o(.text._ZNSt6vectorIN7RayoPdf6Layout5BlockESaIS2_EE17_M_realloc_insertIJRKS2_EEEvN9__gnu_cxx17__normal_iteratorIPS2_S4_EEDpOT_)
    *librayopdf_layout.a:semantics.cpp.o(.text._ZN7RayoPdf6Layout12_GLOBAL__N_110TitleNotesERKSt6vectorINS0_8PageDataESaIS3_EERS2_INS0_5BlockESaIS8_EERS2_INS0_9BlockLineESaISC_EESB_RKSE_RS2_INS0_7NoteRefESaISI_EE)
    *librayopdf_layout.a:semantics.cpp.o(.text._ZN7RayoPdf6Layout12_GLOBAL__N_110PlaceNotesERKSt6vectorINS0_8PageDataESaIS3_EERS2_INS0_5BlockESaIS8_EERKS2_INS0_9BlockLineESaISC_EERKSA_RKS2_INS0_7NoteRefESaISJ_EE)
    *librayopdf_layout.a:semantics.cpp.o(.text._ZNSt6vectorIhSaIhEE17_M_realloc_insertIJRKhEEEvN9__gnu_cxx17__normal_iteratorIPhS1_EEDpOT_)
    *librayopdf_layout.a:semantics.cpp.o(.text._ZN7RayoPdf6Layout12_GLOBAL__N_112CollectMarksERKNS0_8PageDataERNS1_5MarksE)
    *librayopdf_layout.a:semantics.cpp.o(.text._ZN7RayoPdf6Layout12_GLOBAL__N_19FindNotesERKSt6vectorINS0_8PageDataESaIS3_EERS2_INS1_4InfoESaIS8_EEfRKNS1_5MarksERS2_INS0_7NoteRefESaISF_EE)
    *librayopdf_layout.a:semantics.cpp.o(.text._ZNSt10_HashtableIiSt4pairIKimESaIS2_ENSt8__detail10_Select1stESt8equal_toIiESt4hashIiENS4_18_Mod_range_hashingENS4_20_Default_ranged_hashENS4_20_Prime_rehash_policyENS4_17_Hashtable_traitsILb0ELb0ELb1EEEE21_M_insert_unique_nodeEmmPNS4_10_Hash_nodeIS2_Lb0EEEm)
    *librayopdf_layout.a:semantics.cpp.o(.text._ZNSt8__detail9_Map_baseIiSt4pairIKimESaIS3_ENS_10_Select1stESt8equal_toIiESt4hashIiENS_18_Mod_range_hashingENS_20_Default_ranged_hashENS_20_Prime_rehash_policyENS_17_Hashtable_traitsILb0ELb0ELb1EEELb1EEixEOi)
    *librayopdf_layout.a:semantics.cpp.o(.text._ZN7RayoPdf6Layout11BuildBlocksERKSt6vectorINS0_8PageDataESaIS2_EERKS1_INS0_12OutlineEntryESaIS7_EERKS1_IhSaIhEEbRNS0_9BlockListE)
    *librayopdf_layout.a:structure.cpp.o(.text._ZN7RayoPdf6Layout12TaggedLayoutC2Ev)
    *librayopdf_layout.a:structure.cpp.o(.text._ZN7RayoPdf6Layout12TaggedLayoutD2Ev)
    *librayopdf_layout.a:structure.cpp.o(.text._ZN7RayoPdf6Layout13ReadStructureERKNS_8DocumentEiiRNS0_9StructureE)
    *librayopdf_layout.a:tables.cpp.o(.text._ZN7RayoPdf9PerThreadINS_6Layout12_GLOBAL__N_112TableScratchEEERT_v.part.0)
    *librayopdf_layout.a:tables.cpp.o(.text._ZN7RayoPdf6Layout12_GLOBAL__N_112TableScratchaSEOS2_.constprop.0.isra.0)
    *librayopdf_layout.a:tables.cpp.o(.text._ZN7RayoPdf6Layout12_GLOBAL__N_112TableScratchD2Ev)
    *librayopdf_layout.a:tables.cpp.o(.text._ZN7RayoPdf6Layout19ReleaseTableScratchEv)
    *librayopdf_layout.a:figures.cpp.o(.text._ZN7RayoPdf9PerThreadINS_6Layout12_GLOBAL__N_113FigureScratchEEERT_v.part.0)
    *librayopdf_layout.a:figures.cpp.o(.text._ZN7RayoPdf9PerThreadINS_6Layout12_GLOBAL__N_111AxisScratchEEERT_v.part.0)
    *librayopdf_layout.a:figures.cpp.o(.text._ZN7RayoPdf6Layout12_GLOBAL__N_111AxisScratchD2Ev)
    *librayopdf_layout.a:figures.cpp.o(.text._ZN7RayoPdf6Layout12_GLOBAL__N_113FigureScratchD2Ev)
    *librayopdf_layout.a:figures.cpp.o(.text._ZN7RayoPdf6Layout20ReleaseFigureScratchEv)
    *librayopdf_layout.a:images.cpp.o(.text._ZN7RayoPdf6Layout11PlaceImagesERSt6vectorINS0_8PageDataESaIS2_EERKNS0_11ImageOutputERNS0_13ConvertReportE)
    *librayopdf_layout.a:lines.cpp.o(.text._ZN7RayoPdf9PerThreadINS_6Layout12_GLOBAL__N_112PlaceScratchEEERT_v.part.0)
    *librayopdf_layout.a:lines.cpp.o(.text._ZSt16__introsort_loopIN9__gnu_cxx17__normal_iteratorIPjSt6vectorIjSaIjEEEElNS0_5__ops15_Iter_comp_iterIZN7RayoPdf6Layout12_GLOBAL__N_111PlaceGlyphsINSB_12FiniteMinMaxEEEvRNSA_8PageDataERS5_bRKS5_EUljjE0_EEEvT_SL_T0_T1_.constprop.0)
    *librayopdf_layout.a:lines.cpp.o(.text._ZNSt6vectorIN7RayoPdf6Layout12_GLOBAL__N_15GroupESaIS3_EE17_M_realloc_insertIJRKS3_EEEvN9__gnu_cxx17__normal_iteratorIPS3_S5_EEDpOT_.constprop.0)
    *librayopdf_layout.a:lines.cpp.o(.text._ZNSt6vectorIN7RayoPdf6Layout12_GLOBAL__N_18FragmentESaIS3_EE12emplace_backIJEEERS3_DpOT_.constprop.0)
    *librayopdf_layout.a:lines.cpp.o(.text._ZNSt6vectorIN7RayoPdf6Layout12_GLOBAL__N_15ProtoESaIS3_EE17_M_realloc_insertIJRKS3_EEEvN9__gnu_cxx17__normal_iteratorIPS3_S5_EEDpOT_.constprop.0)
    *librayopdf_layout.a:lines.cpp.o(.text._ZN7RayoPdf6Layout12_GLOBAL__N_112PlaceScratchaSEOS2_.constprop.0.isra.0)
    *librayopdf_layout.a:lines.cpp.o(.text._ZN7RayoPdf6Layout12_GLOBAL__N_112PlaceScratchD2Ev)
    *librayopdf_layout.a:lines.cpp.o(.text._ZSt16__insertion_sortIN9__gnu_cxx17__normal_iteratorIPjSt6vectorIjSaIjEEEENS0_5__ops15_Iter_comp_iterIZN7RayoPdf6Layout12_GLOBAL__N_111PlaceGlyphsINSB_12FiniteMinMaxEEEvRNSA_8PageDataERS5_bRKS5_EUljjE0_EEEvT_SL_T0_.constprop.0)
    *librayopdf_layout.a:lines.cpp.o(.text._ZSt16__insertion_sortIN9__gnu_cxx17__normal_iteratorIPjSt6vectorIjSaIjEEEENS0_5__ops15_Iter_comp_iterIZN7RayoPdf6Layout12_GLOBAL__N_111PlaceGlyphsINSB_12FiniteMinMaxEEEvRNSA_8PageDataERS5_bRKS5_EUljjE2_EEEvT_SL_T0_.constprop.0)
    *librayopdf_layout.a:lines.cpp.o(.text._ZSt16__insertion_sortIN9__gnu_cxx17__normal_iteratorIPjSt6vectorIjSaIjEEEENS0_5__ops15_Iter_comp_iterIZN7RayoPdf6Layout12_GLOBAL__N_111PlaceGlyphsINSB_12FiniteMinMaxEEEvRNSA_8PageDataERS5_bRKS5_EUljjE_EEEvT_SL_T0_.constprop.0)
    *librayopdf_layout.a:lines.cpp.o(.text._ZNSt6vectorIjSaIjEE13_M_assign_auxIN9__gnu_cxx17__normal_iteratorIPjS1_EEEEvT_S7_St20forward_iterator_tag.isra.0)
    *librayopdf_layout.a:lines.cpp.o(.text._ZSt16__introsort_loopIN9__gnu_cxx17__normal_iteratorIPjSt6vectorIjSaIjEEEElNS0_5__ops15_Iter_comp_iterIZN7RayoPdf6Layout12_GLOBAL__N_111PlaceGlyphsINSB_12FiniteMinMaxEEEvRNSA_8PageDataERS5_bRKS5_EUljjE2_EEEvT_SL_T0_T1_.constprop.0)
    *librayopdf_layout.a:lines.cpp.o(.text._ZSt16__introsort_loopIN9__gnu_cxx17__normal_iteratorIPjSt6vectorIjSaIjEEEElNS0_5__ops15_Iter_comp_iterIZN7RayoPdf6Layout12_GLOBAL__N_111PlaceGlyphsINSB_12FiniteMinMaxEEEvRNSA_8PageDataERS5_bRKS5_EUljjE_EEEvT_SL_T0_T1_.constprop.0)
    *librayopdf_layout.a:lines.cpp.o(.text._ZN7RayoPdf6Layout12_GLOBAL__N_16Folder5PlaceEj)
    *librayopdf_layout.a:lines.cpp.o(.text._ZN7RayoPdf6Layout12_GLOBAL__N_112SeatDropCapsERKNS0_8PageDataERKSt6vectorIjSaIjEERS5_INS1_8FragmentESaISA_EE.constprop.0)
    *librayopdf_layout.a:lines.cpp.o(.text._ZN7RayoPdf6Layout11ParseMarkerESt17basic_string_viewIcSt11char_traitsIcEERj)
    *librayopdf_layout.a:lines.cpp.o(.text._ZN7RayoPdf6Layout14AppendLineTextERKNS0_8PageDataERKNS0_4LineERNSt7__cxx1112basic_stringIcSt11char_traitsIcESaIcEEEj)
    *librayopdf_layout.a:lines.cpp.o(.text._ZN7RayoPdf6Layout9IsCaptionESt17basic_string_viewIcSt11char_traitsIcEE)
    *librayopdf_layout.a:lines.cpp.o(.text._ZN7RayoPdf6Layout18ReleaseLineScratchEv)
    *librayopdf_layout.a:lines.cpp.o(.text._ZN7RayoPdf6Layout12_GLOBAL__N_110FinishLineERNS0_8PageDataERNS0_4LineEfft)
    *librayopdf_layout.a:lines.cpp.o(.text._ZNSt6vectorIN7RayoPdf6Layout4LineESaIS2_EE7reserveEm)
    *librayopdf_layout.a:lines.cpp.o(.text._ZN7RayoPdf6Layout12_GLOBAL__N_111PlaceGlyphsINS1_12FiniteMinMaxEEEvRNS0_8PageDataERSt6vectorIjSaIjEEbRKS8_.constprop.0)
    *librayopdf_layout.a:lines.cpp.o(.text._ZN7RayoPdf6Layout10BuildLinesERNS0_8PageDataEb)
    *librayopdf_layout.a:markdown_writer.cpp.o(.text._ZN7RayoPdf6Layout12_GLOBAL__N_16Writer14JoinLeaderDotsEm)
    *librayopdf_layout.a:markdown_writer.cpp.o(.text._ZN7RayoPdf6Layout12_GLOBAL__N_16Writer19DropNeedlessEscapesEm)
    *librayopdf_layout.a:markdown_writer.cpp.o(.text._ZN7RayoPdf6Layout12_GLOBAL__N_16Writer6InlineERKNS0_5BlockEb)
    *librayopdf_layout.a:markdown_writer.cpp.o(.text._ZN7RayoPdf6Layout13WriteMarkdownERKSt6vectorINS0_8PageDataESaIS2_EERKNS0_9BlockListEbRNSt7__cxx1112basic_stringIcSt11char_traitsIcESaIcEEERNS0_11WriteCountsENS0_8MathModeERKNS0_13WriteSettingsEPS1_INS0_12WrittenBlockESaISN_EE)
    *librayopdf_text.a:font.cpp.o(.text._ZN7RayoPdf4Text12_GLOBAL__N_17ExtentsERKNS1_10DescriptorEddRdS5_)
    *librayopdf_text.a:font.cpp.o(.text._ZNSt7__cxx1112basic_stringIcSt11char_traitsIcESaIcEE12_M_constructIPKcEEvT_S8_St20forward_iterator_tag.isra.0)
    *librayopdf_text.a:font.cpp.o(.text._ZN7RayoPdf4Text12_GLOBAL__N_114ReadDescriptorERKNS_8DocumentERKNS_8PdfValueERNS0_9FontStyleE)
    *librayopdf_text.a:font.cpp.o(.text._ZN7RayoPdf4Text12_GLOBAL__N_110BaseNameOfERKNS_8DocumentERKNS_8PdfValueE)
    *librayopdf_text.a:font.cpp.o(.text._ZN7RayoPdf4Text12_GLOBAL__N_113StyleFromNameESt17basic_string_viewIcSt11char_traitsIcEERNS0_9FontStyleE)
    *librayopdf_text.a:font.cpp.o(.text._ZNK7RayoPdf4Text4Font8BaseNameEv)
    *librayopdf_text.a:font.cpp.o(.text._ZNK7RayoPdf4Text4Font5StyleEv)
    *librayopdf_text.a:font.cpp.o(.text._ZNK7RayoPdf4Text4Font8VerticalEv)
    *librayopdf_text.a:font.cpp.o(.text._ZNK7RayoPdf4Text4Font6AscentEv)
    *librayopdf_text.a:font.cpp.o(.text._ZNK7RayoPdf4Text4Font7DescentEv)
    *librayopdf_text.a:font.cpp.o(.text._ZNK7RayoPdf4Text4Font7EmScaleEv)
    *librayopdf_text.a:font.cpp.o(.text._ZN7RayoPdf4Text9FontCacheC2ERKNS_8DocumentE)
    *librayopdf_text.a:font.cpp.o(.text._ZN7RayoPdf4Text12_GLOBAL__N_113LoadToUnicodeERKNS_8DocumentERKNS_8PdfValueERKNS0_6Repair7ContextERNS0_12ToUnicodeMapEPmRb)
    *librayopdf_text.a:font.cpp.o(.text._ZN7RayoPdf4Text4Font4ImplD2Ev)
    *librayopdf_text.a:font.cpp.o(.text._ZNSt10_HashtableImSt4pairIKmN7RayoPdf4Text9FontCache5EntryEESaIS6_ENSt8__detail10_Select1stESt8equal_toImESt4hashImENS8_18_Mod_range_hashingENS8_20_Default_ranged_hashENS8_20_Prime_rehash_policyENS8_17_Hashtable_traitsILb0ELb0ELb1EEEE5clearEv)
    *librayopdf_text.a:font.cpp.o(.text._ZN7RayoPdf4Text9FontCache5ClearEv)
    *librayopdf_text.a:font.cpp.o(.text._ZNSt8__detail9_Map_baseImSt4pairIKmN7RayoPdf4Text9FontCache5EntryEESaIS7_ENS_10_Select1stESt8equal_toImESt4hashImENS_18_Mod_range_hashingENS_20_Default_ranged_hashENS_20_Prime_rehash_policyENS_17_Hashtable_traitsILb0ELb0ELb1EEELb1EEixERS2_)
    *librayopdf_text.a:font.cpp.o(.text._ZNK7RayoPdf4Text9FontCache4LoadERKNS_8PdfValueEb)
    *librayopdf_text.a:font.cpp.o(.text._ZN7RayoPdf4Text9FontCache3GetERKNS_8PdfValueE)
    *librayopdf_text.a:repair.cpp.o(.text._ZN7RayoPdf4Text6Repair14ContextForNameESt17basic_string_viewIcSt11char_traitsIcEE)
    *librayopdf_pdf.a:content_lexer.cpp.o(.text._ZN7RayoPdf12ContentLexerC2ESt17basic_string_viewIcSt11char_traitsIcEE)
    *librayopdf_pdf.a:content_lexer.cpp.o(.text._ZNSt6vectorIN7RayoPdf8PdfValueESaIS1_EE17_M_realloc_insertIJEEEvN9__gnu_cxx17__normal_iteratorIPS1_S3_EEDpOT_)
    *librayopdf_pdf.a:content_lexer.cpp.o(.text._ZN7RayoPdf12ContentLexer9ReadValueERNS_6Syntax6CursorEmRNS1_7BuilderERNS_8PdfValueE)
    *librayopdf_pdf.a:content_lexer.cpp.o(.text._ZN7RayoPdf12ContentLexer4PushERKNS_8PdfValueE)
    *librayopdf_pdf.a:content_lexer.cpp.o(.text._ZN7RayoPdf12ContentLexer9DelimiterEv)
    *librayopdf_pdf.a:document.cpp.o(.text._ZN7RayoPdf12_GLOBAL__N_112ReadUnsignedESt17basic_string_viewIcSt11char_traitsIcEERm)
    *librayopdf_pdf.a:document.cpp.o(.text._ZN7RayoPdf12_GLOBAL__N_18FindFromESt17basic_string_viewIcSt11char_traitsIcEEmS4_m)
    *librayopdf_pdf.a:document.cpp.o(.text._ZNSt6vectorIN7RayoPdf12_GLOBAL__N_14SlotESaIS2_EE17_M_default_appendEm)
    *librayopdf_pdf.a:document.cpp.o(.text._ZNK7RayoPdf8Document4Impl9SectionAtEm)
    *librayopdf_pdf.a:document.cpp.o(.text._ZNK7RayoPdf8Document5BytesEv)
    *librayopdf_pdf.a:document.cpp.o(.text._ZNK7RayoPdf8Document7CatalogEv)
    *librayopdf_pdf.a:document.cpp.o(.text._ZNK7RayoPdf8Document6ReportEv)
    *librayopdf_pdf.a:document.cpp.o(.text._ZNK7RayoPdf8Document9PageCountEv)
    *librayopdf_pdf.a:document.cpp.o(.text._ZNK7RayoPdf8Document8PageDictEi)
    *librayopdf_pdf.a:document.cpp.o(.text._ZN7RayoPdf8Document18ReleasePageContentEv)
    *librayopdf_pdf.a:document.cpp.o(.text._ZN7RayoPdf8Document4Impl9StreamEndEml)
    *librayopdf_pdf.a:document.cpp.o(.text._ZN7RayoPdf8Document4Impl6ObjectEj)
    *librayopdf_pdf.a:document.cpp.o(.text._ZN7RayoPdf8Document4Impl13ParseIndirectEmlbbRNS_8PdfValueERjS4_)
    *librayopdf_pdf.a:document.cpp.o(.text._ZNK7RayoPdf8Document6ObjectEj)
    *librayopdf_pdf.a:document.cpp.o(.text._ZNK7RayoPdf8Document7ResolveERKNS_8PdfValueE)
    *librayopdf_pdf.a:document.cpp.o(.text._ZNK7RayoPdf8Document3GetERKNS_8PdfValueESt17basic_string_viewIcSt11char_traitsIcEE)
    *librayopdf_pdf.a:document.cpp.o(.text._ZN7RayoPdf8Document4Impl3GetERKNS_8PdfValueESt17basic_string_viewIcSt11char_traitsIcEE)
    *librayopdf_pdf.a:document.cpp.o(.text._ZN7RayoPdf8Document4Impl6FinishEv)
    *librayopdf_pdf.a:document.cpp.o(.text._ZN7RayoPdf8Document4Impl6IsLeafERKNS_8PdfValueE)
    *librayopdf_pdf.a:document.cpp.o(.text._ZN7RayoPdf8Document4Impl11ResolvePageEm)
    *librayopdf_pdf.a:document.cpp.o(.text._ZNK7RayoPdf8Document7CropBoxEi)
    *librayopdf_pdf.a:document.cpp.o(.text._ZNK7RayoPdf8Document6RotateEi)
    *librayopdf_pdf.a:document.cpp.o(.text._ZNK7RayoPdf8Document9ResourcesEi)
    *librayopdf_pdf.a:document.cpp.o(.text._ZN7RayoPdf8Document4Impl12GatherStagesERKNS_8PdfValueEbPNS_7Filters5StageERmRSt17basic_string_viewIcSt11char_traitsIcEE)
    *librayopdf_pdf.a:document.cpp.o(.text._ZN7RayoPdf8Document4Impl7PrepareERKNS_8PdfValueERmPNS_7Filters5StageES5_RNSt7__cxx1112basic_stringIcSt11char_traitsIcESaIcEEERSt17basic_string_viewIcSC_ERNS_12StreamStatusE)
    *librayopdf_pdf.a:document.cpp.o(.text._ZN7RayoPdf8Document4Impl14StreamDataIntoERKNS_8PdfValueERNS_7Inflate6OutputEmmRNSt7__cxx1112basic_stringIcSt11char_traitsIcESaIcEEERm)
    *librayopdf_pdf.a:document.cpp.o(.text._ZNK7RayoPdf8Document11PageContentEiRSt17basic_string_viewIcSt11char_traitsIcEE)
    *librayopdf_pdf.a:document.cpp.o(.text._ZN7RayoPdf8Document4Impl15SetUpEncryptionESt17basic_string_viewIcSt11char_traitsIcEE)
    *librayopdf_pdf.a:document.cpp.o(.text._ZNSt6vectorIN7RayoPdf8Document4Impl4PageESaIS3_EE17_M_realloc_insertIJRKS3_EEEvN9__gnu_cxx17__normal_iteratorIPS3_S5_EEDpOT_)
    *librayopdf_pdf.a:document.cpp.o(.text._ZN7RayoPdf8Document4Impl13ReadXrefChainEv)
    *librayopdf_pdf.a:document.cpp.o(.text._ZNSt6vectorIZN7RayoPdf8Document4Impl12WalkPageTreeERKNS0_8PdfValueEE5FrameSaIS6_EE17_M_realloc_insertIJS6_EEEvN9__gnu_cxx17__normal_iteratorIPS6_S8_EEDpOT_)
    *librayopdf_pdf.a:document.cpp.o(.text._ZNSt6vectorIZN7RayoPdf8Document4Impl12WalkPageTreeERKNS0_8PdfValueEE5FrameSaIS6_EE12emplace_backIJS6_EEERS6_DpOT_.isra.0)
    *librayopdf_pdf.a:document.cpp.o(.text._ZN7RayoPdf8Document4Impl12WalkPageTreeERKNS_8PdfValueE)
    *librayopdf_pdf.a:document.cpp.o(.text._ZN7RayoPdf8Document4OpenESt17basic_string_viewIcSt11char_traitsIcEES4_RSt10unique_ptrIS0_St14default_deleteIS0_EE)
    *librayopdf_pdf.a:inflate.cpp.o(.text._ZN7RayoPdf7Inflate12UseHugePagesEb)
    *librayopdf_pdf.a:inflate.cpp.o(.text._ZN7RayoPdf7Inflate6Output7ReleaseEv)
    *librayopdf_pdf.a:syntax.cpp.o(.text._ZNK7RayoPdf8PdfValue3IntEl)
    *librayopdf_pdf.a:syntax.cpp.o(.text._ZNK7RayoPdf8PdfValue4FindESt17basic_string_viewIcSt11char_traitsIcEE)
    *librayopdf_pdf.a:syntax.cpp.o(.text._ZN7RayoPdf8PdfArena11AllocateNewEm)
    *librayopdf_pdf.a:syntax.cpp.o(.text._ZN7RayoPdf6Syntax9SkipSpaceERNS0_6CursorE)
    *librayopdf_pdf.a:syntax.cpp.o(.text._ZN7RayoPdf6Syntax9SkipWhiteERNS0_6CursorE)
    *librayopdf_pdf.a:syntax.cpp.o(.text._ZN7RayoPdf6Syntax9ReadTokenERNS0_6CursorE)
    *librayopdf_pdf.a:syntax.cpp.o(.text._ZN7RayoPdf6Syntax8ReadNameERNS0_6CursorERNS0_7BuilderERSt17basic_string_viewIcSt11char_traitsIcEE)
    *librayopdf_pdf.a:syntax.cpp.o(.text._ZN7RayoPdf6Syntax17ReadLiteralStringERNS0_6CursorERNS0_7BuilderERSt17basic_string_viewIcSt11char_traitsIcEE)
    *librayopdf_pdf.a:syntax.cpp.o(.text._ZN7RayoPdf8PdfArenaD2Ev)
    *librayopdf_pdf.a:syntax.cpp.o(.text._ZNSt6vectorIN7RayoPdf12PdfDictEntryESaIS1_EE17_M_realloc_insertIJRKS1_EEEvN9__gnu_cxx17__normal_iteratorIPS1_S3_EEDpOT_)
    *librayopdf_pdf.a:syntax.cpp.o(.text._ZN7RayoPdf6Syntax12_GLOBAL__N_19ParseDictERNS0_6CursorENS0_4ModeEiRNS0_7BuilderERNS_8PdfValueE)
    *librayopdf_pdf.a:syntax.cpp.o(.text._ZN7RayoPdf6Syntax12_GLOBAL__N_110ParseArrayERNS0_6CursorENS0_4ModeEiRNS0_7BuilderERNS_8PdfValueE)
    *librayopdf_pdf.a:syntax.cpp.o(.text._ZN7RayoPdf6Syntax10ParseValueERNS0_6CursorENS0_4ModeEiRNS0_7BuilderERNS_8PdfValueE)
    *librayopdf_common.a:file.cpp.o(.text._ZN7RayoPdf4File12_GLOBAL__N_17WriteFdEiSt17basic_string_viewIcSt11char_traitsIcEE)
    *librayopdf_common.a:file.cpp.o(.text._ZNSt7__cxx1112basic_stringIcSt11char_traitsIcESaIcEE12_M_constructIPKcEEvT_S8_St20forward_iterator_tag.isra.0)
    *librayopdf_common.a:file.cpp.o(.text._ZN7RayoPdf4File12_GLOBAL__N_115CreateTemporaryERKNSt7__cxx1112basic_stringIcSt11char_traitsIcESaIcEEERS7_.constprop.0)
    *librayopdf_common.a:file.cpp.o(.text._ZN7RayoPdf4File9InputFile4OpenERKNSt7__cxx1112basic_stringIcSt11char_traitsIcESaIcEEEmPS7_)
    *librayopdf_common.a:file.cpp.o(.text._ZN7RayoPdf4File8WriteAllERKNSt7__cxx1112basic_stringIcSt11char_traitsIcESaIcEEESt17basic_string_viewIcS4_E)
    *librayopdf_common.a:file.cpp.o(.text._ZN7RayoPdf4File9ArgumentsB5cxx11EiPPc)
    *libstdc++.a:atexit_thread.o(.text.__cxa_thread_atexit)
    *libstdc++.a:del_ops.o(.text._ZdlPvm)
    *libstdc++.a:guard.o(.text.__cxa_guard_acquire)
    *libstdc++.a:guard.o(.text.__cxa_guard_release)
    *libstdc++.a:new_op.o(.text._Znwm)
    *libstdc++.a:hashtable_c++0x.o(.text._ZNKSt8__detail20_Prime_rehash_policy11_M_next_bktEm)
    *libstdc++.a:hashtable_c++0x.o(.text._ZNKSt8__detail20_Prime_rehash_policy14_M_need_rehashEmmm)
    *libstdc++.a:string-inst.o(.text._ZNSt7__cxx1112basic_stringIcSt11char_traitsIcESaIcEE9_M_createERmm)
    *libstdc++.a:string-inst.o(.text._ZNSt7__cxx1112basic_stringIcSt11char_traitsIcESaIcEE9_M_assignERKS4_)
    *libstdc++.a:string-inst.o(.text._ZNSt7__cxx1112basic_stringIcSt11char_traitsIcESaIcEE9_M_mutateEmmPKcm)
    *libstdc++.a:string-inst.o(.text._ZNSt7__cxx1112basic_stringIcSt11char_traitsIcESaIcEE7reserveEm)
    *libstdc++.a:string-inst.o(.text._ZNSt7__cxx1112basic_stringIcSt11char_traitsIcESaIcEE14_M_replace_auxEmmmc)
    *libstdc++.a:string-inst.o(.text._ZNSt7__cxx1112basic_stringIcSt11char_traitsIcESaIcEE6resizeEmc)
    *libstdc++.a:string-inst.o(.text._ZNSt7__cxx1112basic_stringIcSt11char_traitsIcESaIcEE10_M_replaceEmmPKcm)
    *libstdc++.a:string-inst.o(.text._ZNSt7__cxx1112basic_stringIcSt11char_traitsIcESaIcEE9_M_appendEPKcm)
    *libstdc++.a:string-inst.o(.text._ZNSt7__cxx1112basic_stringIcSt11char_traitsIcESaIcEE4swapERS4_)
    *libstdc++.a:string-inst.o(.text._ZNKSt7__cxx1112basic_stringIcSt11char_traitsIcESaIcEE4findEPKcmm)
    *libstdc++.a:del_op.o(.text._ZdlPv)
    *librayopdf_layout.a:lines.cpp.o(.text._ZN7RayoPdf6Layout8LineTextERKNS0_8PageDataERKNS0_4LineERNSt7__cxx1112basic_stringIcSt11char_traitsIcESaIcEEEj)
    *librayopdf_layout.a:markdown_writer.cpp.o(.text._ZN7RayoPdf6Layout12_GLOBAL__N_16Writer13AppendEscapedESt17basic_string_viewIcSt11char_traitsIcEEb)
    *librayopdf_layout.a:markdown_writer.cpp.o(.text._ZN7RayoPdf6Layout12_GLOBAL__N_111JoiningDashESt17basic_string_viewIcSt11char_traitsIcEE)
    *librayopdf_pdf.a:document.cpp.o(.text._ZNK7RayoPdf8Document4RectERKNS_8PdfValueERNS_7PdfRectE)
    *librayopdf_pdf.a:syntax.cpp.o(.text._ZN7RayoPdf12_GLOBAL__N_19FreeChunkEPvm)
    *librayopdf_pdf.a:syntax.cpp.o(.text._ZN7RayoPdf8PdfArena6RewindEv)
    *librayopdf_layout.a:interpreter.cpp.o(.text._ZN7RayoPdf4Utf86AppendERNSt7__cxx1112basic_stringIcSt11char_traitsIcESaIcEEEj)
    *librayopdf_pdf.a:document.cpp.o(.text._ZN7RayoPdf8Document4Impl11ReadClassicERNS_6Syntax6CursorERNS_8PdfValueE)
    *librayopdf_pdf.a:document.cpp.o(.text._ZNK7RayoPdf8Document6NumberERKNS_8PdfValueERd)
    *librayopdf_layout.a:interpreter.cpp.o(.text._ZN7RayoPdf6Layout12_GLOBAL__N_122AppendGlyphTextGeneralESt17basic_string_viewIcSt11char_traitsIcEERNSt7__cxx1112basic_stringIcS4_SaIcEEE)
    *librayopdf_layout.a:semantics.cpp.o(.text._ZN7RayoPdf6Layout12_GLOBAL__N_113AbstractLabelERKNS0_8PageDataERKNS0_4LineERjS8_.constprop.0.isra.0)
    *librayopdf_text.a:repair.cpp.o(.text._ZN7RayoPdf4Text6Repair6IsJunkEj)
    *librayopdf_text.a:repair.cpp.o(.text._ZN7RayoPdf4Text6Repair9UntrustedERKNS1_8MapStatsE)
    *librayopdf_text.a:cmap.cpp.o(.text._ZN7RayoPdf4Text12_GLOBAL__N_15Lexer4NextERNS1_5TokenE)
    *librayopdf_text.a:cmap.cpp.o(.text._ZN7RayoPdf4Text12_GLOBAL__N_19SectionOfESt17basic_string_viewIcSt11char_traitsIcEE)
    *librayopdf_text.a:cmap.cpp.o(.text._ZNSt6vectorIN7RayoPdf4Text14CodespaceRangeESaIS2_EE17_M_realloc_insertIJRKS2_EEEvN9__gnu_cxx17__normal_iteratorIPS2_S4_EEDpOT_)
    *librayopdf_text.a:cmap.cpp.o(.text._ZN7RayoPdf4Text9Codespace3AddESt17basic_string_viewIcSt11char_traitsIcEES5_)
    *librayopdf_text.a:cmap.cpp.o(.text._ZN7RayoPdf4Text14ParseToUnicodeESt17basic_string_viewIcSt11char_traitsIcEERNS0_12ToUnicodeMapE)
    *librayopdf_pdf.a:document.cpp.o(.text._ZN7RayoPdf8Document4Impl10StreamDataERKNS_8PdfValueERNSt7__cxx1112basic_stringIcSt11char_traitsIcESaIcEEEm)
    *librayopdf_pdf.a:document.cpp.o(.text._ZNK7RayoPdf8Document10StreamDataERKNS_8PdfValueERNSt7__cxx1112basic_stringIcSt11char_traitsIcESaIcEEEm)
    *librayopdf_pdf.a:filters.cpp.o(.text._ZN7RayoPdf7Filters6KindOfESt17basic_string_viewIcSt11char_traitsIcEE)
    *librayopdf_pdf.a:filters.cpp.o(.text._ZN7RayoPdf7Filters15DecodeFlateIntoESt17basic_string_viewIcSt11char_traitsIcEERNS_7Inflate6OutputEmmRm)
    *librayopdf_pdf.a:inflate.cpp.o(.text._ZN7RayoPdf7Inflate12_GLOBAL__N_18Inflater10SkipHeaderEv)
    *librayopdf_pdf.a:inflate.cpp.o(.text._ZN7RayoPdf7Inflate12_GLOBAL__N_18Inflater15DecodeCodesBmi2Ev)
    *librayopdf_pdf.a:inflate.cpp.o(.text._ZN7RayoPdf7Inflate12_GLOBAL__N_110BuildTableINS1_15DistanceEntriesEEEmPKhjjPjmbbRKT_PKj.constprop.0)
    *librayopdf_pdf.a:inflate.cpp.o(.text._ZN7RayoPdf7Inflate12_GLOBAL__N_110BuildTableINS1_13LitLenEntriesEEEmPKhjjPjmbbRKT_PKj.constprop.0)
    *librayopdf_pdf.a:inflate.cpp.o(.text._ZN7RayoPdf7Inflate12_GLOBAL__N_18Inflater17ReadDynamicTablesEv.constprop.0)
    *librayopdf_pdf.a:inflate.cpp.o(.text._ZN7RayoPdf7Inflate6Output7ReserveEm)
    *librayopdf_pdf.a:inflate.cpp.o(.text._ZN7RayoPdf7Inflate12_GLOBAL__N_18Inflater3RunEv.constprop.0)
    *librayopdf_pdf.a:inflate.cpp.o(.text._ZN7RayoPdf7Inflate11InflateIntoESt17basic_string_viewIcSt11char_traitsIcEERNS0_6OutputEmmRm)
    *librayopdf_pdf.a:syntax.cpp.o(.text._ZN7RayoPdf6Syntax11ParseNumberESt17basic_string_viewIcSt11char_traitsIcEERNS_8PdfValueE)
    *librayopdf_pdf.a:syntax.cpp.o(.text._ZN7RayoPdf6Syntax13ReadHexStringERNS0_6CursorERNS0_7BuilderERSt17basic_string_viewIcSt11char_traitsIcEE)
    *librayopdf_common.a:cpu.cpp.o(.text._ZN7RayoPdf11CpuFeaturesEv)
    *librayopdf_layout.a:semantics.cpp.o(.text._ZNSt6vectorIhSaIhEE17_M_default_appendEm)
    *librayopdf_layout.a:lines.cpp.o(.text._ZSt16__insertion_sortIN9__gnu_cxx17__normal_iteratorIPN7RayoPdf6Layout12_GLOBAL__N_115NumberCandidateESt6vectorIS5_SaIS5_EEEENS0_5__ops15_Iter_comp_iterIZNS4_15DropLineNumbersERNS3_8PageDataEEUlRKS5_SG_E_EEEvT_SJ_T0_.isra.0)
    *librayopdf_layout.a:lines.cpp.o(.text._ZN7RayoPdf6Layout12_GLOBAL__N_110MostlyMonoERKNS0_8PageDataERKNS0_4LineEj.isra.0)
    *librayopdf_layout.a:lines.cpp.o(.text._ZSt16__introsort_loopIN9__gnu_cxx17__normal_iteratorIPjSt6vectorIjSaIjEEEElNS0_5__ops15_Iter_comp_iterIZN7RayoPdf6Layout12_GLOBAL__N_115DropLineNumbersERNSA_8PageDataEEUljjE_EEEvT_SG_T0_T1_)
    *librayopdf_layout.a:lines.cpp.o(.text._ZSt16__introsort_loopIN9__gnu_cxx17__normal_iteratorIPN7RayoPdf6Layout12_GLOBAL__N_115NumberCandidateESt6vectorIS5_SaIS5_EEEElNS0_5__ops15_Iter_comp_iterIZNS4_15DropLineNumbersERNS3_8PageDataEEUlRKS5_SG_E_EEEvT_SJ_T0_T1_)
    *librayopdf_layout.a:lines.cpp.o(.text._ZSt16__insertion_sortIN9__gnu_cxx17__normal_iteratorIPjSt6vectorIjSaIjEEEENS0_5__ops15_Iter_comp_iterIZN7RayoPdf6Layout12_GLOBAL__N_115DropLineNumbersERNSA_8PageDataEEUljjE_EEEvT_SG_T0_)
    *librayopdf_text.a:cmap.cpp.o(.text._ZN7RayoPdf4Text12_GLOBAL__N_111UnicodeSink11ExpectCharsEm)
    *librayopdf_text.a:cmap.cpp.o(.text._ZN7RayoPdf4Text12_GLOBAL__N_111UnicodeSink4CharEjRKNS1_5TokenE)
    *librayopdf_pdf.a:syntax.cpp.o(.text._ZN7RayoPdf6Syntax12_GLOBAL__N_15StoreERNS0_7BuilderESt17basic_string_viewIcSt11char_traitsIcEERS7_)
    *librayopdf_layout.a:math.cpp.o(.text._ZNSt6vectorIfSaIfEE17_M_realloc_insertIJRKfEEEvN9__gnu_cxx17__normal_iteratorIPfS1_EEDpOT_)
    *librayopdf_layout.a:semantics.cpp.o(.text._ZN7RayoPdf6Layout12_GLOBAL__N_115NumberingPrefixESt17basic_string_viewIcSt11char_traitsIcEE)
    *librayopdf_layout.a:semantics.cpp.o(.text._ZN7RayoPdf6Layout12_GLOBAL__N_113WriteMatchKeyESt17basic_string_viewIcSt11char_traitsIcEERNSt7__cxx1112basic_stringIcS4_SaIcEEEm)
    *librayopdf_pdf.a:content_lexer.cpp.o(.text._ZNSt6vectorIN7RayoPdf8PdfValueESaIS1_EE17_M_realloc_insertIJRKS1_EEEvN9__gnu_cxx17__normal_iteratorIPS1_S3_EEDpOT_)
    *librayopdf_pdf.a:filters.cpp.o(.text._ZN7RayoPdf7Filters6DecodeENS0_4KindERKNS0_6ParamsESt17basic_string_viewIcSt11char_traitsIcEERNSt7__cxx1112basic_stringIcS7_SaIcEEEm)
    *librayopdf_pdf.a:inflate.cpp.o(.text._ZN7RayoPdf7Inflate7InflateESt17basic_string_viewIcSt11char_traitsIcEERNSt7__cxx1112basic_stringIcS3_SaIcEEEm)
    *librayopdf_layout.a:semantics.cpp.o(.text._ZN7RayoPdf6Layout12_GLOBAL__N_115StandardSectionESt17basic_string_viewIcSt11char_traitsIcEERNSt7__cxx1112basic_stringIcS4_SaIcEEE)
    *librayopdf_layout.a:interpreter.cpp.o(.text._ZNSt6vectorIN7RayoPdf6Layout12_GLOBAL__N_111Interpreter9PathPieceESaIS4_EE12emplace_backIJS4_EEERS4_DpOT_.isra.0)
    *librayopdf_layout.a:interpreter.cpp.o(.text._ZN7RayoPdf6Layout12_GLOBAL__N_111Interpreter5PaintEbb)
    *librayopdf_layout.a:math.cpp.o(.text._ZNSt6vectorIjSaIjEE7reserveEm)
    *librayopdf_layout.a:math.cpp.o(.text._ZNSt6vectorIfSaIfEE17_M_default_appendEm)
    *librayopdf_layout.a:ocr_style.cpp.o(.text._ZNSt6vectorIfSaIfEE17_M_realloc_insertIJfEEEvN9__gnu_cxx17__normal_iteratorIPfS1_EEDpOT_)
    *librayopdf_layout.a:reading_order.cpp.o(.text._ZSt13__introselectIN9__gnu_cxx17__normal_iteratorIPfSt6vectorIfSaIfEEEElNS0_5__ops15_Iter_less_iterEEvT_S9_S9_T0_T1_.isra.0)
    *librayopdf_layout.a:reading_order.cpp.o(.text._ZN7RayoPdf6Layout12_GLOBAL__N_110RunningKeyERKNSt7__cxx1112basic_stringIcSt11char_traitsIcESaIcEEERS7_)
    *librayopdf_layout.a:reading_order.cpp.o(.text._ZSt16__introsort_loopIN9__gnu_cxx17__normal_iteratorIPjSt6vectorIjSaIjEEEElNS0_5__ops15_Iter_comp_iterIZZN7RayoPdf6Layout12_GLOBAL__N_114RemoveEdgeRowsERNSA_8PageDataEfRNSt7__cxx1112basic_stringIcSt11char_traitsIcESaIcEEESK_RNSB_8EdgeRowsEENKUlvE_clEvEUljjE_EEEvT_SQ_T0_T1_)
    *librayopdf_layout.a:reading_order.cpp.o(.text._ZNSt6vectorIjSaIjEE13_M_assign_auxIN9__gnu_cxx17__normal_iteratorIPKjS1_EEEEvT_S8_St20forward_iterator_tag.isra.0)
    *librayopdf_layout.a:reading_order.cpp.o(.text._ZSt16__insertion_sortIN9__gnu_cxx17__normal_iteratorIPjSt6vectorIjSaIjEEEENS0_5__ops15_Iter_comp_iterIZZN7RayoPdf6Layout12_GLOBAL__N_114RemoveEdgeRowsERNSA_8PageDataEfRNSt7__cxx1112basic_stringIcSt11char_traitsIcESaIcEEESK_RNSB_8EdgeRowsEENKUlvE_clEvEUljjE_EEEvT_SQ_T0_)
    *librayopdf_layout.a:reading_order.cpp.o(.text._ZNSt6vectorIjSaIjEE13_M_assign_auxIN9__gnu_cxx17__normal_iteratorIPjS1_EEEEvT_S7_St20forward_iterator_tag.isra.0)
    *librayopdf_layout.a:reading_order.cpp.o(.text._ZZN7RayoPdf6Layout12_GLOBAL__N_114RemoveEdgeRowsERNS0_8PageDataEfRNSt7__cxx1112basic_stringIcSt11char_traitsIcESaIcEEESA_RNS1_8EdgeRowsEENKUlvE_clEv)
    *librayopdf_layout.a:reading_order.cpp.o(.text._ZSt16__insertion_sortIN9__gnu_cxx17__normal_iteratorIPjSt6vectorIjSaIjEEEENS0_5__ops15_Iter_comp_iterIZN7RayoPdf6Layout12_GLOBAL__N_17Orderer6SplitXERS5_fRS3_ImSaImEEEUljjE_EEEvT_SJ_T0_)
    *librayopdf_layout.a:reading_order.cpp.o(.text._ZSt16__insertion_sortIN9__gnu_cxx17__normal_iteratorIPjSt6vectorIjSaIjEEEENS0_5__ops15_Iter_comp_iterIZN7RayoPdf6Layout12_GLOBAL__N_114RemoveEdgeRowsERNSA_8PageDataEfRNSt7__cxx1112basic_stringIcSt11char_traitsIcESaIcEEESK_RNSB_8EdgeRowsEEUljjE_EEEvT_SP_T0_)
    *librayopdf_layout.a:reading_order.cpp.o(.text._ZSt16__introsort_loopIN9__gnu_cxx17__normal_iteratorIPjSt6vectorIjSaIjEEEElNS0_5__ops15_Iter_comp_iterIZN7RayoPdf6Layout12_GLOBAL__N_17Orderer6SplitXERS5_fRS3_ImSaImEEEUljjE_EEEvT_SJ_T0_T1_)
    *librayopdf_layout.a:reading_order.cpp.o(.text._ZSt16__introsort_loopIN9__gnu_cxx17__normal_iteratorIPjSt6vectorIjSaIjEEEElNS0_5__ops15_Iter_comp_iterIZN7RayoPdf6Layout12_GLOBAL__N_114RemoveEdgeRowsERNSA_8PageDataEfRNSt7__cxx1112basic_stringIcSt11char_traitsIcESaIcEEESK_RNSB_8EdgeRowsEEUljjE_EEEvT_SP_T0_T1_)
    *librayopdf_layout.a:reading_order.cpp.o(.text._ZSt13__introselectIN9__gnu_cxx17__normal_iteratorIPjSt6vectorIjSaIjEEEElNS0_5__ops15_Iter_comp_iterIZN7RayoPdf6Layout12_GLOBAL__N_17Orderer10MedianSizeERKS5_EUljjE_EEEvT_SH_SH_T0_T1_)
    *librayopdf_layout.a:reading_order.cpp.o(.text._ZNSt6vectorIjSaIjEE15_M_range_insertIN9__gnu_cxx17__normal_iteratorIPjS1_EEEEvS6_T_S7_St20forward_iterator_tag.isra.0)
    *librayopdf_layout.a:reading_order.cpp.o(.text._ZN7RayoPdf6Layout12_GLOBAL__N_17Orderer8FallbackERSt6vectorIjSaIjEE)
    *librayopdf_layout.a:reading_order.cpp.o(.text._ZN7RayoPdf6Layout12_GLOBAL__N_17Orderer6SplitXERSt6vectorIjSaIjEEfRS3_ImSaImEE)
    *librayopdf_layout.a:reading_order.cpp.o(.text._ZN7RayoPdf6Layout12_GLOBAL__N_17Orderer13DropLabelCutsERKSt6vectorIjSaIjEERS3_ImSaImEEf.isra.0)
    *librayopdf_layout.a:reading_order.cpp.o(.text._ZN7RayoPdf6Layout12_GLOBAL__N_17Orderer3CutERSt6vectorIjSaIjEEi)
    *librayopdf_layout.a:reading_order.cpp.o(.text._ZN7RayoPdf6Layout12_GLOBAL__N_17Orderer5OrderERSt6vectorIjSaIjEE)
    *librayopdf_layout.a:reading_order.cpp.o(.text._ZN7RayoPdf6Layout12_GLOBAL__N_114RemoveEdgeRowsERNS0_8PageDataEfRNSt7__cxx1112basic_stringIcSt11char_traitsIcESaIcEEESA_RNS1_8EdgeRowsE)
    *librayopdf_layout.a:reading_order.cpp.o(.text._ZN7RayoPdf6Layout18RemoveRunningLinesERSt6vectorINS0_8PageDataESaIS2_EEPKNS0_11FeatureSinkE)
    *librayopdf_layout.a:reading_order.cpp.o(.text._ZN7RayoPdf6Layout10OrderLinesERNS0_8PageDataE)
    *librayopdf_layout.a:tables.cpp.o(.text._ZN7RayoPdf6Layout12_GLOBAL__N_18DetectorC2ERNS0_8PageDataERNS0_17TableContinuationEh)
    *librayopdf_layout.a:tables.cpp.o(.text._ZNSt6vectorIN7RayoPdf6Layout12_GLOBAL__N_13RowESaIS3_EE17_M_realloc_insertIJRKS3_EEEvN9__gnu_cxx17__normal_iteratorIPS3_S5_EEDpOT_)
    *librayopdf_layout.a:tables.cpp.o(.text._ZNSt6vectorIN7RayoPdf6Layout12_GLOBAL__N_15TWordESaIS3_EE7reserveEm)
    *librayopdf_layout.a:tables.cpp.o(.text._ZSt16__insertion_sortIN9__gnu_cxx17__normal_iteratorIPfSt6vectorIfSaIfEEEENS0_5__ops15_Iter_less_iterEEvT_S9_T0_.isra.0)
    *librayopdf_layout.a:tables.cpp.o(.text._ZN7RayoPdf6Layout12_GLOBAL__N_18DetectorD2Ev)
    *librayopdf_layout.a:tables.cpp.o(.text._ZN7RayoPdf6Layout12_GLOBAL__N_110MergeEdgesERSt6vectorINS1_4EdgeESaIS3_EE)
    *librayopdf_layout.a:tables.cpp.o(.text._ZN7RayoPdf6Layout12_GLOBAL__N_18Detector9BuildRowsEffffRSt6vectorINS1_3RowESaIS4_EERS3_IjSaIjEE)
    *librayopdf_layout.a:tables.cpp.o(.text._ZN7RayoPdf6Layout12_GLOBAL__N_18Detector6CommitEv)
    *librayopdf_layout.a:tables.cpp.o(.text._ZSt13__introselectIN9__gnu_cxx17__normal_iteratorIPfSt6vectorIfSaIfEEEElNS0_5__ops15_Iter_less_iterEEvT_S9_S9_T0_T1_.isra.0)
    *librayopdf_layout.a:tables.cpp.o(.text._ZN7RayoPdf6Layout12_GLOBAL__N_18Detector10RuleStacksEv)
    *librayopdf_layout.a:tables.cpp.o(.text._ZN7RayoPdf6Layout12_GLOBAL__N_18Detector10BorderlessEf)
    *librayopdf_layout.a:tables.cpp.o(.text._ZN7RayoPdf6Layout12_GLOBAL__N_18Detector11JoinStackedEv)
    *librayopdf_layout.a:tables.cpp.o(.text._ZN7RayoPdf6Layout12_GLOBAL__N_18Detector11JoinStripesEv)
    *librayopdf_layout.a:tables.cpp.o(.text._ZN7RayoPdf6Layout12_GLOBAL__N_18Detector8LatticesEv)
    *librayopdf_layout.a:tables.cpp.o(.text._ZN7RayoPdf6Layout12_GLOBAL__N_18Detector8BoxGridsEv)
    *librayopdf_layout.a:tables.cpp.o(.text._ZN7RayoPdf6Layout12_GLOBAL__N_18Detector3RunEv)
    *librayopdf_layout.a:tables.cpp.o(.text._ZN7RayoPdf6Layout12DetectTablesERNS0_8PageDataERNS0_17TableContinuationE)
    *librayopdf_layout.a:figures.cpp.o(.text._ZN7RayoPdf6Layout14MarkFigureTextERNS0_8PageDataE)
    *librayopdf_layout.a:lines.cpp.o(.text._ZN7RayoPdf6Layout16AppendGlyphTextsERKNS0_8PageDataERKNS0_4LineEjjRNSt7__cxx1112basic_stringIcSt11char_traitsIcESaIcEEE)
    *librayopdf_layout.a:lines.cpp.o(.text._ZN7RayoPdf6Layout18SplitRunInHeadingsERNS0_8PageDataE)
    *librayopdf_layout.a:interpreter.cpp.o(.text._ZN7RayoPdf6Layout12_GLOBAL__N_111Interpreter9EndMarkedEv)
    *librayopdf_layout.a:interpreter.cpp.o(.text._ZN7RayoPdf6Layout12_GLOBAL__N_111Interpreter11BeginMarkedESt17basic_string_viewIcSt11char_traitsIcEEPKNS_8PdfValueERS8_)
    *librayopdf_layout.a:reading_order.cpp.o(.text._ZN7RayoPdf6Layout12_GLOBAL__N_115IsPageNumberKeyERKNSt7__cxx1112basic_stringIcSt11char_traitsIcESaIcEEE)
    *librayopdf_layout.a:semantics.cpp.o(.text._ZN7RayoPdf6Layout12_GLOBAL__N_17NoTitleESt17basic_string_viewIcSt11char_traitsIcEE)
    *librayopdf_layout.a:semantics.cpp.o(.text._ZZN7RayoPdf6Layout11BuildBlocksERKSt6vectorINS0_8PageDataESaIS2_EERKS1_INS0_12OutlineEntryESaIS7_EERKS1_IhSaIhEEbRNS0_9BlockListEENKUlvE1_clEv)
    *librayopdf_text.a:font.cpp.o(.text._ZNKSt14default_deleteIN7RayoPdf4Text12_GLOBAL__N_110SimpleLoadEEclEPS3_.part.0)
    *librayopdf_text.a:font.cpp.o(.text._ZN7RayoPdf4Text12_GLOBAL__N_117ReadDeclaredNamesERKNS_8DocumentERKNS_8PdfValueENS0_8FontKindERKNSt7__cxx1112basic_stringIcSt11char_traitsIcESaIcEEERKNS1_10DescriptorERNS1_11SimpleNamesE)
    *librayopdf_text.a:font.cpp.o(.text._ZN7RayoPdf4Text12_GLOBAL__N_110LoadSimpleERKNS_8DocumentERKNS_8PdfValueENS0_8FontKindERNS0_4Font4ImplE)
    *librayopdf_text.a:tables.cpp.o(.text._ZN7RayoPdf4Text6Tables18StandardFontByNameESt17basic_string_viewIcSt11char_traitsIcEE)
    *librayopdf_pdf.a:content_lexer.cpp.o(.text._ZN7RayoPdf12ContentLexer9ReadArrayERNS_6Syntax6CursorEmRNS1_7BuilderERNS_8PdfValueE)
    *librayopdf_layout.a:markdown_writer.cpp.o(.text._ZNSt6vectorIN7RayoPdf6Layout12_GLOBAL__N_18GlyphRefESaIS3_EE17_M_default_appendEm)
    *librayopdf_layout.a:markdown_writer.cpp.o(.text._ZZN7RayoPdf6Layout12_GLOBAL__N_16Writer10WriteWordsERKNS0_5BlockEENKUljE_clEj)
    *librayopdf_layout.a:markdown_writer.cpp.o(.text._ZN7RayoPdf6Layout12_GLOBAL__N_16Writer14RepairFlankingEmi)
    *librayopdf_layout.a:markdown_writer.cpp.o(.text._ZN7RayoPdf6Layout12_GLOBAL__N_16Writer10WriteWordsERKNS0_5BlockE)
    *librayopdf_layout.a:markdown_writer.cpp.o(.text._ZN7RayoPdf6Layout12_GLOBAL__N_16Writer12CollectWordsERKNS0_5BlockE)
    *librayopdf_layout.a:markdown_writer.cpp.o(.text._ZN7RayoPdf6Layout12_GLOBAL__N_16Writer10StyleWordsEb)
    *librayopdf_layout.a:reading_order.cpp.o(.text._ZSt16__insertion_sortIN9__gnu_cxx17__normal_iteratorIPjSt6vectorIjSaIjEEEENS0_5__ops15_Iter_comp_iterIZN7RayoPdf6Layout12_GLOBAL__N_17Orderer10SplitXSoftERS5_fRS3_ImSaImEEEUljjE_EEEvT_SJ_T0_)
    *librayopdf_layout.a:reading_order.cpp.o(.text._ZN7RayoPdf6Layout12_GLOBAL__N_18HasFolioERKNSt7__cxx1112basic_stringIcSt11char_traitsIcESaIcEEES9_.isra.0)
    *librayopdf_layout.a:reading_order.cpp.o(.text._ZSt16__introsort_loopIN9__gnu_cxx17__normal_iteratorIPjSt6vectorIjSaIjEEEElNS0_5__ops15_Iter_comp_iterIZN7RayoPdf6Layout12_GLOBAL__N_17Orderer10SplitXSoftERS5_fRS3_ImSaImEEEUljjE_EEEvT_SJ_T0_T1_)
    *librayopdf_layout.a:semantics.cpp.o(.text._ZN7RayoPdf6Layout12_GLOBAL__N_113SmallCapsSizeERKSt6vectorINS0_8PageDataESaIS3_EERKS2_INS1_4InfoESaIS8_EERKNS1_8RawBlockE.isra.0)
    *(.text._ZnwmRKSt9nothrow_t)
    *librayopdf_layout.a:interpreter.cpp.o(.text._ZN7RayoPdf6Layout12_GLOBAL__N_110UnitSquareERKNS1_6MatrixE)
    *librayopdf_layout.a:interpreter.cpp.o(.text._ZNSt6vectorIN7RayoPdf6Layout5ShapeESaIS2_EE17_M_realloc_insertIJRKS2_EEEvN9__gnu_cxx17__normal_iteratorIPS2_S4_EEDpOT_)
    *librayopdf_layout.a:interpreter.cpp.o(.text._ZNSt6vectorIN7RayoPdf6Layout6RulingESaIS2_EE17_M_realloc_insertIJS2_EEEvN9__gnu_cxx17__normal_iteratorIPS2_S4_EEDpOT_)
    *librayopdf_layout.a:tables.cpp.o(.text._ZNSt6vectorIiSaIiEE17_M_default_appendEm)
    *libstdc++.a:hash_bytes.o(.text._ZSt11_Hash_bytesPKvmm)
    *librayopdf_layout.a:interpreter.cpp.o(.text._ZZN7RayoPdf6Layout12_GLOBAL__N_111Interpreter5PaintEbbENKUlddddE_clEdddd)
    *librayopdf_layout.a:markdown_writer.cpp.o(.text._ZNSt6vectorIN7RayoPdf6Layout12_GLOBAL__N_19DelimiterESaIS3_EE17_M_realloc_insertIJS3_EEEvN9__gnu_cxx17__normal_iteratorIPS3_S5_EEDpOT_)
    *librayopdf_layout.a:markdown_writer.cpp.o(.text._ZN7RayoPdf6Layout12_GLOBAL__N_16Writer11ChangeStyleEhj)
    *librayopdf_layout.a:markdown_writer.cpp.o(.text._ZN7RayoPdf6Layout12_GLOBAL__N_19FlankBitsEj)
    *librayopdf_text.a:cmap.cpp.o(.text._ZN7RayoPdf4Text12_GLOBAL__N_17UnitsOfESt17basic_string_viewIcSt11char_traitsIcEEPtm.constprop.0)
    *librayopdf_layout.a:convert.cpp.o(.text._ZZN7RayoPdf6Layout8PagePool3RunIZNS0_12_GLOBAL__N_115InterpretSharedERKNS_8DocumentERKNS0_14ConvertOptionsEiRNS3_10ConversionERNS0_13ConvertReportEEUljmE_EEvmOT_ENUlPvjmE_4_FUNESH_jm)
    *librayopdf_layout.a:convert.cpp.o(.text._ZN7RayoPdf6Layout12_GLOBAL__N_111ThreadStart11ContentReadEPvm)
    *librayopdf_layout.a:interpreter.cpp.o(.text._ZN7RayoPdf6Layout12_GLOBAL__N_16FiniteERKNS1_6MatrixE)
    *librayopdf_layout.a:page_pool.cpp.o(.text._ZN7RayoPdf6Layout8PagePoolC2Ej)
    *librayopdf_layout.a:page_pool.cpp.o(.text._ZN7RayoPdf6Layout8PagePool3RunEjmPFvPvjmES2_)
    *librayopdf_layout.a:pipeline.cpp.o(.text._ZZN7RayoPdf6Layout8PagePool3RunIZNS0_12ConvertPagesERSt6vectorINS0_8PageDataESaIS4_EERKS3_INS0_15PageTextQualityESaIS8_EERKS3_INS0_12OutlineEntryESaISD_EEbRNSt7__cxx1112basic_stringIcSt11char_traitsIcESaIcEEERNS0_13ConvertReportEPKNS0_11ImageOutputEPKNS0_9StructureENS0_8MathModeEPS1_PKNS0_12DocumentReadEPKNS0_14OutputSettingsEEUljmE_EEvmOT_ENUlPvjmE_4_FUNES18_jm)
    *librayopdf_layout.a:reading_order.cpp.o(.text._ZN7RayoPdf6Layout12_GLOBAL__N_17Orderer11TopologicalERKSt6vectorIjSaIjEE)
    *librayopdf_layout.a:semantics.cpp.o(.text._ZNSt6vectorIPKN7RayoPdf6Layout5ShapeESaIS4_EE17_M_realloc_insertIJS4_EEEvN9__gnu_cxx17__normal_iteratorIPS4_S6_EEDpOT_)
    *librayopdf_layout.a:structure.cpp.o(.text._ZNSt6vectorIiSaIiEE14_M_fill_assignEmRKi)
    *librayopdf_layout.a:tables.cpp.o(.text._ZNSt6vectorItSaItEE14_M_fill_assignEmRKt)
    *librayopdf_text.a:font.cpp.o(.text._ZN7RayoPdf4Text9FontCacheC2ERS1_)
    *librayopdf_text.a:font.cpp.o(.text._ZN7RayoPdf4Text9FontCacheD2Ev)
    *librayopdf_text.a:font.cpp.o(.text._ZN7RayoPdf4Text9FontCache9GetSharedERKNS_8PdfValueE)
    *librayopdf_pdf.a:document.cpp.o(.text._ZNSt6vectorISt4pairIjN7RayoPdf12_GLOBAL__N_14SlotEESaIS4_EE12emplace_backIJRjRS3_EEERS4_DpOT_.isra.0)
    *librayopdf_pdf.a:document.cpp.o(.text._ZNK7RayoPdf8Document11BeginSharedEv)
    *librayopdf_pdf.a:document.cpp.o(.text._ZNK7RayoPdf8Document9EndSharedEv)
    *librayopdf_pdf.a:document.cpp.o(.text._ZNK7RayoPdf8Document12SharedIntactEv)
    *librayopdf_pdf.a:document.cpp.o(.text._ZN7RayoPdf8Document4Impl12ObjectSharedEj)
    *librayopdf_pdf.a:syntax.cpp.o(.text._ZN7RayoPdf6Syntax12_GLOBAL__N_117ReadEscapedStringERNS0_6CursorERNS0_7BuilderEmRSt17basic_string_viewIcSt11char_traitsIcEE)
    *librayopdf_common.a:batch.cpp.o(.text._ZN7RayoPdf5Batch10UsableCpusEv)
    *librayopdf_common.a:batch.cpp.o(.text._ZN7RayoPdf5Batch11WorkerCountEjm)
    *libstdc++.a:condition_variable.o(.text._ZNSt18condition_variableC2Ev)
    *libstdc++.a:condition_variable.o(.text._ZNSt18condition_variable10notify_allEv)
    *librayopdf_layout.a:interpreter.cpp.o(.text._ZN7RayoPdf6Layout16AppendTextStringESt17basic_string_viewIcSt11char_traitsIcEERNSt7__cxx1112basic_stringIcS3_SaIcEEE)
    *librayopdf_layout.a:math.cpp.o(.text._ZNSt6vectorIN7RayoPdf6Layout4LineESaIS2_EE17_M_realloc_insertIJRKS2_EEEvN9__gnu_cxx17__normal_iteratorIPS2_S4_EEDpOT_)
    *librayopdf_pdf.a:content_lexer.cpp.o(.text._ZN7RayoPdf12ContentLexer5TokenEPKcS2_RSt17basic_string_viewIcSt11char_traitsIcEE)
    *librayopdf_layout.a:reading_order.cpp.o(.text._ZSt16__insertion_sortIN9__gnu_cxx17__normal_iteratorIPjSt6vectorIjSaIjEEEENS0_5__ops15_Iter_comp_iterIZN7RayoPdf6Layout12_GLOBAL__N_17Orderer10CrossLinesERKS5_RS5_SF_EUljjE0_EEEvT_SI_T0_)
    *librayopdf_layout.a:reading_order.cpp.o(.text._ZSt16__introsort_loopIN9__gnu_cxx17__normal_iteratorIPjSt6vectorIjSaIjEEEElNS0_5__ops15_Iter_comp_iterIZN7RayoPdf6Layout12_GLOBAL__N_17Orderer10CrossLinesERKS5_RS5_SF_EUljjE0_EEEvT_SI_T0_T1_)
    *Scrt1.o(.text)
    *librayopdf_layout.a:semantics.cpp.o(.text._ZN7RayoPdf6Layout12_GLOBAL__N_113FirstTextByteERKNS0_8PageDataERKNS0_4LineE.isra.0)
    *rcrt1.o(.text)
    *(.text._dl_get_origin)
    *libm-*.a:s_ceil.o(.text)
    *libm-*.a:s_floor.o(.text)
    *libm-*.a:e_logf.o(.text)
    *libm-*.a:s_lroundf.o(.text)
    *libm-*.a:e_log.o(.text)
    *libc.a:libc-start.o(.text)
    *libc.a:libc-tls.o(.text)
    *libc.a:ctype-info.o(.text)
    *libc.a:bsd-_setjmp.o(.text)
    *libc.a:cxa_atexit.o(.text)
    *libc.a:cxa_thread_atexit_impl.o(.text)
    *libc.a:getenv.o(.text)
    *libc.a:rename.o(.text)
    *libc.a:iofflush.o(.text)
    *libc.a:genops.o(.text)
    *libc.a:libc-cleanup.o(.text)
    *libc.a:pthread_mutex_conf.o(.text)
    *libc.a:pthread_mutex_lock.o(.text)
    *libc.a:pthread_mutex_unlock.o(.text)
    *libc.a:malloc.o(.text)
    *libc.a:memchr.o(.text)
    *libc.a:memcmp.o(.text)
    *libc.a:memcpy.o(.text)
    *libc.a:memmove.o(.text)
    *libc.a:mempcpy.o(.text)
    *libc.a:memset.o(.text)
    *libc.a:stpcpy.o(.text)
    *libc.a:strcasecmp_l.o(.text)
    *libc.a:strchr.o(.text)
    *libc.a:strchrnul.o(.text)
    *libc.a:strcmp.o(.text)
    *libc.a:strcpy.o(.text)
    *libc.a:strcspn.o(.text)
    *libc.a:strdup.o(.text)
    *libc.a:strlen.o(.text)
    *libc.a:strncmp.o(.text)
    *libc.a:strncpy.o(.text)
    *libc.a:strstr.o(.text)
    *libc.a:memchr-avx2.o(.text.avx)
    *libc.a:memcmp-avx2-movbe.o(.text.avx)
    *libc.a:memmove-avx-unaligned-erms.o(.text.avx)
    *libc.a:memset-avx2-unaligned-erms.o(.text.avx)
    *libc.a:strchr-avx2.o(.text.avx)
    *libc.a:strcspn-sse4.o(.text.sse4.2)
    *libc.a:strlen-avx2.o(.text.avx)
    *libc.a:strncmp-avx2.o(.text.avx)
    *libc.a:clock_gettime.o(.text)
    *libc.a:_exit.o(.text)
    *libc.a:getpid.o(.text)
    *libc.a:close.o(.text)
    *libc.a:fstat64.o(.text)
    *libc.a:open64.o(.text)
    *libc.a:write.o(.text)
    *libc.a:getrlimit64.o(.text)
    *libc.a:brk.o(.text)
    *libc.a:mmap64.o(.text)
    *libc.a:mprotect.o(.text)
    *libc.a:sbrk.o(.text)
    *libc.a:init-misc.o(.text)
    *libc.a:setvmaname.o(.text)
    *libc.a:memcpy_chk-nonshared.o(.text)
    *libc.a:dl-debug.o(.text)
    *libc.a:dl-load.o(.text)
    *libc.a:dl-open.o(.text)
    *libc.a:dl-reloc.o(.text)
    *libc.a:dl-tls.o(.text)
    *libc.a:dl-tls_init_tp.o(.text)
    *libc.a:dl-tunables.o(.text)
    *libc.a:dl-cet.o(.text)
    *libc.a:dl-early_allocate.o(.text)
    *libc.a:dl-reloc-static-pie.o(.text)
    *libc.a:dl-support.o(.text)
    *libc.a:libc_early_init.o(.text)
    *libc.a:init-first.o(.text)
    *libc.a:setjmp.o(.text)
    *libc.a:sigjmp.o(.text)
    *libc.a:elision-conf.o(.text)
    *libc.a:strnlen.o(.text)
    *libc.a:strrchr.o(.text)
    *libc.a:strsep.o(.text)
    *libc.a:strrchr-avx2.o(.text.avx)
    *libc.a:wcslen.o(.text)
    *libc.a:wcsnlen.o(.text)
    *libc.a:wmemset.o(.text)
    *libc.a:dl-find_object.o(.text)
    *libc.a:strpbrk.o(.text)
    *libc.a:strspn.o(.text)
    *libc.a:wmemchr.o(.text)
    *libc.a:strcasecmp.o(.text)
    *libc.a:strncase.o(.text)
    *librayopdf_layout.a:semantics.cpp.o(.text._ZNSt6vectorIiSaIiEE17_M_realloc_insertIJRKiEEEvN9__gnu_cxx17__normal_iteratorIPiS1_EEDpOT_)
    *librayopdf_layout.a:lines.cpp.o(.text._ZSt25__unguarded_linear_insertIN9__gnu_cxx17__normal_iteratorIPN7RayoPdf6Layout12_GLOBAL__N_115NumberCandidateESt6vectorIS5_SaIS5_EEEENS0_5__ops14_Val_comp_iterIZNS4_15DropLineNumbersERNS3_8PageDataEEUlRKS5_SG_E_EEEvT_T0_.isra.0)
    *librayopdf_text.a:font.cpp.o(.text._ZN7RayoPdf4Text12_GLOBAL__N_114EncodingByNameESt17basic_string_viewIcSt11char_traitsIcEERNS0_6Tables8EncodingE)
    *librayopdf_text.a:font.cpp.o(.text._ZNK7RayoPdf4Text4Font8NextSlowESt17basic_string_viewIcSt11char_traitsIcEERmRNS0_4CodeE)
    *librayopdf_pdf.a:document.cpp.o(.text._ZN7RayoPdf8Document4Impl14CountUncountedEm)
    *librayopdf_layout.a:features.cpp.o(.text._ZN7RayoPdf6Layout10TextSharesESt17basic_string_viewIcSt11char_traitsIcEERfS5_Rb)
    *librayopdf_layout.a:features.cpp.o(.text._ZN7RayoPdf6Layout9TextWordsESt17basic_string_viewIcSt11char_traitsIcEERfS5_Rb)
    *librayopdf_text.a:font.cpp.o(.text._ZNSt6vectorIN7RayoPdf4Text12_GLOBAL__N_110WidthRangeESaIS3_EE12emplace_backIJS3_EEERS3_DpOT_.isra.0)
    *librayopdf_text.a:font.cpp.o(.text._ZN7RayoPdf4Text12_GLOBAL__N_19NamedCMapESt17basic_string_viewIcSt11char_traitsIcEERiRb.constprop.0)
    *librayopdf_text.a:font.cpp.o(.text._ZN7RayoPdf4Text12_GLOBAL__N_19LoadType0ERKNS_8DocumentERKNS_8PdfValueERNS0_4Font4ImplE)
    *librayopdf_text.a:cjk.cpp.o(.text._ZN7RayoPdf4Text3Cjk16CollectionByNameESt17basic_string_viewIcSt11char_traitsIcEES5_)
    *librayopdf_text.a:cjk.cpp.o(.text._ZN7RayoPdf4Text3Cjk14FindPredefinedESt17basic_string_viewIcSt11char_traitsIcEE)
    *librayopdf_text.a:cjk.cpp.o(.text._ZN7RayoPdf4Text3Cjk12CollectionOfEi)
    *librayopdf_text.a:cmap.cpp.o(.text._ZNK7RayoPdf4Text12ToUnicodeMap4FindEj)
    *librayopdf_text.a:cmap.cpp.o(.text._ZN7RayoPdf4Text12ToUnicodeMap5IndexEv)
    *librayopdf_layout.a:reading_order.cpp.o(.text._ZNSt6vectorImSaImEE14_M_fill_assignEmRKm)
    *librayopdf_layout.a:tables.cpp.o(.text._ZNSt6vectorIN7RayoPdf6Layout12_GLOBAL__N_13GapESaIS3_EE17_M_realloc_insertIJRKS3_EEEvN9__gnu_cxx17__normal_iteratorIPS3_S5_EEDpOT_)
    *librayopdf_layout.a:lines.cpp.o(.text._ZN7RayoPdf6Layout12_GLOBAL__N_112OpeningQuoteESt17basic_string_viewIcSt11char_traitsIcEE)
    *librayopdf_text.a:font.cpp.o(.text._ZN7RayoPdf4Text10UsableTextESt17basic_string_viewIcSt11char_traitsIcEE)
    *librayopdf_layout.a:semantics.cpp.o(.text._ZNSt6vectorIN7RayoPdf6Layout9BlockLineESaIS2_EE12emplace_backIJS2_EEERS2_DpOT_.isra.0)
    *librayopdf_layout.a:semantics.cpp.o(.text._ZN7RayoPdf6Layout12_GLOBAL__N_18MatchKeyESt17basic_string_viewIcSt11char_traitsIcEERNSt7__cxx1112basic_stringIcS4_SaIcEEEb)
    *librayopdf_layout.a:tables.cpp.o(.text._ZNSt6vectorIN7RayoPdf6Layout12_GLOBAL__N_13GapESaIS3_EE17_M_default_appendEm)
    *librayopdf_layout.a:tables.cpp.o(.text._ZNK7RayoPdf6Layout12_GLOBAL__N_18Detector6AddInkERKNS1_3RowERKSt6vectorIjSaIjEERKNS1_3InkERSB_)
    *libc.a:memset_chk-nonshared.o(.text)
    *librayopdf_layout.a:interpreter.cpp.o(.text._ZNSt6vectorIZN7RayoPdf6Layout11ReadOutlineERKNS0_8DocumentERS_INS1_12OutlineEntryESaIS5_EEE7PendingSaIS9_EE12emplace_backIJS9_EEERS9_DpOT_.isra.0)
    *librayopdf_layout.a:interpreter.cpp.o(.text._ZNSt6vectorIN7RayoPdf6Layout12OutlineEntryESaIS2_EE17_M_realloc_insertIJS2_EEEvN9__gnu_cxx17__normal_iteratorIPS2_S4_EEDpOT_)
    *librayopdf_layout.a:semantics.cpp.o(.text._ZN7RayoPdf6Layout12_GLOBAL__N_112EndsInLeaderESt17basic_string_viewIcSt11char_traitsIcEE)
    *librayopdf_layout.a:semantics.cpp.o(.text._ZN7RayoPdf6Layout12_GLOBAL__N_117NumberingKeyBytesESt17basic_string_viewIcSt11char_traitsIcEE)
    *librayopdf_layout.a:semantics.cpp.o(.text._ZNSt8__detail9_Map_baseIiSt4pairIKiiESaIS3_ENS_10_Select1stESt8equal_toIiESt4hashIiENS_18_Mod_range_hashingENS_20_Default_ranged_hashENS_20_Prime_rehash_policyENS_17_Hashtable_traitsILb0ELb0ELb1EEELb1EEixEOi)
    *librayopdf_layout.a:semantics.cpp.o(.text._ZNKSt10_HashtableINSt7__cxx1112basic_stringIcSt11char_traitsIcESaIcEEESt4pairIKS5_St6vectorIjSaIjEEESaISB_ENSt8__detail10_Select1stESt8equal_toIS5_ESt4hashIS5_ENSD_18_Mod_range_hashingENSD_20_Default_ranged_hashENSD_20_Prime_rehash_policyENSD_17_Hashtable_traitsILb1ELb0ELb1EEEE19_M_find_before_nodeEmRS7_m)
    *librayopdf_layout.a:semantics.cpp.o(.text._ZNSt10_HashtableINSt7__cxx1112basic_stringIcSt11char_traitsIcESaIcEEESt4pairIKS5_St6vectorIjSaIjEEESaISB_ENSt8__detail10_Select1stESt8equal_toIS5_ESt4hashIS5_ENSD_18_Mod_range_hashingENSD_20_Default_ranged_hashENSD_20_Prime_rehash_policyENSD_17_Hashtable_traitsILb1ELb0ELb1EEEE4findERS7_)
    *librayopdf_layout.a:semantics.cpp.o(.text._ZNSt8__detail9_Map_baseINSt7__cxx1112basic_stringIcSt11char_traitsIcESaIcEEESt4pairIKS6_St6vectorIjSaIjEEESaISC_ENS_10_Select1stESt8equal_toIS6_ESt4hashIS6_ENS_18_Mod_range_hashingENS_20_Default_ranged_hashENS_20_Prime_rehash_policyENS_17_Hashtable_traitsILb1ELb0ELb1EEELb1EEixERS8_)
    *librayopdf_layout.a:lines.cpp.o(.text._ZN7RayoPdf6Layout12_GLOBAL__N_114RaisedNoteMarkERKNS0_8PageDataEPKjjRKNS0_5GlyphE)
    *librayopdf_layout.a:markdown_writer.cpp.o(.text._ZN7RayoPdf6Layout12_GLOBAL__N_111AddFragmentESt17basic_string_viewIcSt11char_traitsIcEERjRb)
    *librayopdf_text.a:font.cpp.o(.text._ZN7RayoPdf4Text12_GLOBAL__N_19CountTextESt17basic_string_viewIcSt11char_traitsIcEERNS0_6Repair8MapStatsE)
    *librayopdf_text.a:repair.cpp.o(.text._ZN7RayoPdf4Text6Repair5CountESt17basic_string_viewIcSt11char_traitsIcEERNS1_8MapStatsE)
    *librayopdf_text.a:cmap.cpp.o(.text._ZN7RayoPdf4Text12_GLOBAL__N_111AppendUtf16EPKtmRNSt7__cxx1112basic_stringIcSt11char_traitsIcESaIcEEE)
    *librayopdf_layout.a:math.cpp.o(.text._ZNSt6vectorINSt7__cxx1112basic_stringIcSt11char_traitsIcESaIcEEESaIS5_EE17_M_default_appendEm)
    *librayopdf_layout.a:structure.cpp.o(.text._ZNSt6vectorIN7RayoPdf6Layout12_GLOBAL__N_16Reader5FrameESaIS4_EE12emplace_backIJS4_EEERS4_DpOT_.constprop.0.isra.0)
    *librayopdf_layout.a:structure.cpp.o(.text._ZN7RayoPdf6Layout12_GLOBAL__N_18FindItemERKNS0_9StructureEjji)
    *librayopdf_layout.a:structure.cpp.o(.text._ZSt16__introsort_loopIN9__gnu_cxx17__normal_iteratorIPSt4pairIPKN7RayoPdf8PdfValueEjESt6vectorIS7_SaIS7_EEEElNS0_5__ops15_Iter_comp_iterIZNS3_6Layout12_GLOBAL__N_16Reader3RunEvEUlRKS7_SJ_E_EEEvT_SM_T0_T1_)
    *librayopdf_layout.a:structure.cpp.o(.text._ZSt16__insertion_sortIN9__gnu_cxx17__normal_iteratorIPSt4pairIPKN7RayoPdf8PdfValueEjESt6vectorIS7_SaIS7_EEEENS0_5__ops15_Iter_comp_iterIZNS3_6Layout12_GLOBAL__N_16Reader3RunEvEUlRKS7_SJ_E_EEEvT_SM_T0_.isra.0)
    *librayopdf_layout.a:structure.cpp.o(.text._ZSt25__unguarded_linear_insertIN9__gnu_cxx17__normal_iteratorIPN7RayoPdf6Layout10StructItemESt6vectorIS4_SaIS4_EEEENS0_5__ops14_Val_comp_iterIZNS3_12_GLOBAL__N_16Reader3RunEvEUlRKS4_SF_E_EEEvT_T0_)
    *librayopdf_layout.a:structure.cpp.o(.text._ZSt16__insertion_sortIN9__gnu_cxx17__normal_iteratorIPN7RayoPdf6Layout10StructItemESt6vectorIS4_SaIS4_EEEENS0_5__ops15_Iter_comp_iterIZNS3_12_GLOBAL__N_16Reader3RunEvEUlRKS4_SF_E_EEEvT_SI_T0_)
    *librayopdf_layout.a:structure.cpp.o(.text._ZSt16__introsort_loopIN9__gnu_cxx17__normal_iteratorIPN7RayoPdf6Layout10StructItemESt6vectorIS4_SaIS4_EEEElNS0_5__ops15_Iter_comp_iterIZNS3_12_GLOBAL__N_16Reader3RunEvEUlRKS4_SF_E_EEEvT_SI_T0_T1_)
    *librayopdf_layout.a:structure.cpp.o(.text._ZNSt6vectorIN7RayoPdf6Layout10StructItemESaIS2_EE17_M_realloc_insertIJRKS2_EEEvN9__gnu_cxx17__normal_iteratorIPS2_S4_EEDpOT_)
    *librayopdf_layout.a:structure.cpp.o(.text._ZN7RayoPdf6Layout12_GLOBAL__N_16Reader7AddItemEPKNS_8PdfValueEjijj)
    *librayopdf_layout.a:structure.cpp.o(.text._ZNSt6vectorIN7RayoPdf6Layout10StructNodeESaIS2_EE17_M_realloc_insertIJRKS2_EEEvN9__gnu_cxx17__normal_iteratorIPS2_S4_EEDpOT_)
    *librayopdf_layout.a:structure.cpp.o(.text._ZNSt6vectorIN7RayoPdf6Layout12TaggedLayout5OwnerESaIS3_EE17_M_realloc_insertIJRKS3_EEEvN9__gnu_cxx17__normal_iteratorIPS3_S5_EEDpOT_)
    *librayopdf_layout.a:structure.cpp.o(.text._ZNSt6vectorIS_IjSaIjEESaIS1_EE14_M_fill_assignEmRKS1_)
    *librayopdf_layout.a:structure.cpp.o(.text._ZNSt6vectorIS_ImSaImEESaIS1_EE14_M_fill_assignEmRKS1_)
    *librayopdf_layout.a:structure.cpp.o(.text._ZNSt6vectorIN7RayoPdf6Layout9TableCellESaIS2_EE17_M_realloc_insertIJRKS2_EEEvN9__gnu_cxx17__normal_iteratorIPS2_S4_EEDpOT_)
    *librayopdf_layout.a:structure.cpp.o(.text._ZNSt6vectorIN7RayoPdf6Layout5TableESaIS2_EE17_M_realloc_insertIJRKS2_EEEvN9__gnu_cxx17__normal_iteratorIPS2_S4_EEDpOT_)
    *librayopdf_layout.a:structure.cpp.o(.text._ZN7RayoPdf6Layout12TaggedLayout10FindOwnersEv)
    *librayopdf_layout.a:structure.cpp.o(.text._ZN7RayoPdf6Layout12TaggedLayout7PrepareERSt6vectorINS0_8PageDataESaIS3_EERKNS0_9StructureE)
    *librayopdf_layout.a:structure.cpp.o(.text._ZN7RayoPdf6Layout12_GLOBAL__N_16Reader11ResolveRoleESt17basic_string_viewIcSt11char_traitsIcEERNS0_10StructRoleERhRi.constprop.0.isra.0)
    *librayopdf_layout.a:tables.cpp.o(.text._ZNSt6vectorIN7RayoPdf6Layout12_GLOBAL__N_14EdgeESaIS3_EE17_M_realloc_insertIJRKS3_EEEvN9__gnu_cxx17__normal_iteratorIPS3_S5_EEDpOT_)
    *librayopdf_layout.a:tables.cpp.o(.text._ZSt16__insertion_sortIN9__gnu_cxx17__normal_iteratorIPN7RayoPdf6Layout12_GLOBAL__N_14EdgeESt6vectorIS5_SaIS5_EEEENS0_5__ops15_Iter_comp_iterIZNS4_10MergeEdgesERS9_EUlRKS5_SF_E_EEEvT_SI_T0_.isra.0)
    *librayopdf_layout.a:tables.cpp.o(.text._ZSt16__insertion_sortIN9__gnu_cxx17__normal_iteratorIPN7RayoPdf6Layout12_GLOBAL__N_14EdgeESt6vectorIS5_SaIS5_EEEENS0_5__ops15_Iter_comp_iterIZNS4_10MergeEdgesERS9_EUlRKS5_SF_E0_EEEvT_SI_T0_.isra.0)
    *librayopdf_layout.a:tables.cpp.o(.text._ZNSt6vectorIiSaIiEE12emplace_backIJiEEERiDpOT_.isra.0)
    *librayopdf_layout.a:tables.cpp.o(.text._ZN7RayoPdf6Layout12_GLOBAL__N_111TrimLeadersESt17basic_string_viewIcSt11char_traitsIcEE)
    *librayopdf_layout.a:tables.cpp.o(.text._ZZN7RayoPdf6Layout13WriteGfmTableERKSt6vectorINS0_9TablePartESaIS2_EERNSt7__cxx1112basic_stringIcSt11char_traitsIcESaIcEEEbbENKUlSt17basic_string_viewIcSA_EE_clESF_)
    *librayopdf_layout.a:tables.cpp.o(.text._ZSt16__introsort_loopIN9__gnu_cxx17__normal_iteratorIPN7RayoPdf6Layout12_GLOBAL__N_14EdgeESt6vectorIS5_SaIS5_EEEElNS0_5__ops15_Iter_comp_iterIZNS4_10MergeEdgesERS9_EUlRKS5_SF_E0_EEEvT_SI_T0_T1_)
    *librayopdf_layout.a:tables.cpp.o(.text._ZSt16__introsort_loopIN9__gnu_cxx17__normal_iteratorIPN7RayoPdf6Layout12_GLOBAL__N_14EdgeESt6vectorIS5_SaIS5_EEEElNS0_5__ops15_Iter_comp_iterIZNS4_10MergeEdgesERS9_EUlRKS5_SF_E_EEEvT_SI_T0_T1_)
    *librayopdf_layout.a:tables.cpp.o(.text._ZN7RayoPdf6Layout14TableNeedsHtmlERKNS0_8PageDataERKNS0_5TableE)
    *librayopdf_layout.a:tables.cpp.o(.text._ZN7RayoPdf6Layout13WriteGfmTableERKSt6vectorINS0_9TablePartESaIS2_EERNSt7__cxx1112basic_stringIcSt11char_traitsIcESaIcEEEbb)
    *librayopdf_layout.a:markdown_writer.cpp.o(.text._ZN7RayoPdf6Layout12_GLOBAL__N_111InnerHyphenERKNS0_8PageDataEm)
    *librayopdf_layout.a:markdown_writer.cpp.o(.text._ZN7RayoPdf6Layout12_GLOBAL__N_120FunctionWordCompoundERKNS0_8PageDataERKNS0_4LineEj.isra.0)
    *librayopdf_layout.a:markdown_writer.cpp.o(.text._ZN7RayoPdf6Layout12_GLOBAL__N_16Writer13KnownCompoundERKNS0_8PageDataERKNS0_4LineEjS5_S8_j)
    *librayopdf_layout.a:markdown_writer.cpp.o(.text._ZNSt6vectorIN7RayoPdf6Layout9TablePartESaIS2_EE17_M_realloc_insertIJS2_EEEvN9__gnu_cxx17__normal_iteratorIPS2_S4_EEDpOT_)
    *librayopdf_layout.a:model.cpp.o(.text._ZN7RayoPdf6Layout12_GLOBAL__N_14LeafERKNS0_9TreeModelEjPKf)
    *librayopdf_layout.a:model.cpp.o(.text._ZN7RayoPdf6Layout12ScoreReachesERKNS0_9TreeModelEPKfd)
    *librayopdf_text.a:font.cpp.o(.text._ZN7RayoPdf4Text12_GLOBAL__N_121FinishSpaceWidthType0ERNS0_4Font4ImplEb)
    *librayopdf_pdf.a:document.cpp.o(.text._ZNK7RayoPdf8Document11ObjectCountEv)
    *librayopdf_layout.a:interpreter.cpp.o(.text._ZNSt6vectorIN7RayoPdf6Layout8LinkAreaESaIS2_EE17_M_realloc_insertIJRKS2_EEEvN9__gnu_cxx17__normal_iteratorIPS2_S4_EEDpOT_)
    *librayopdf_layout.a:tables.cpp.o(.text._ZNSt6vectorIfSaIfEE14_M_fill_assignEmRKf)
    *librayopdf_layout.a:tables.cpp.o(.text._ZSt16__introsort_loopIN9__gnu_cxx17__normal_iteratorIPjSt6vectorIjSaIjEEEElNS0_5__ops15_Iter_less_iterEEvT_S9_T0_T1_.isra.0)
    *librayopdf_layout.a:tables.cpp.o(.text._ZSt16__insertion_sortIN9__gnu_cxx17__normal_iteratorIPjSt6vectorIjSaIjEEEENS0_5__ops15_Iter_less_iterEEvT_S9_T0_.isra.0)
    *librayopdf_layout.a:tables.cpp.o(.text._ZSt16__insertion_sortIN9__gnu_cxx17__normal_iteratorIPN7RayoPdf6Layout12_GLOBAL__N_14EdgeESt6vectorIS5_SaIS5_EEEENS0_5__ops15_Iter_comp_iterIZNS4_8Detector10RuleStacksEvEUlRKS5_SF_E_EEEvT_SI_T0_.isra.0)
    *librayopdf_layout.a:tables.cpp.o(.text._ZNSt6vectorIZN7RayoPdf6Layout12_GLOBAL__N_18Detector10RuleStacksEvE5StackSaIS4_EE17_M_realloc_insertIJS4_EEEvN9__gnu_cxx17__normal_iteratorIPS4_S6_EEDpOT_)
    *librayopdf_layout.a:tables.cpp.o(.text._ZSt16__insertion_sortIN9__gnu_cxx17__normal_iteratorIPZN7RayoPdf6Layout12_GLOBAL__N_18Detector10RuleStacksEvE5StackSt6vectorIS6_SaIS6_EEEENS0_5__ops15_Iter_comp_iterIZNS5_10RuleStacksEvEUlRKS6_SF_E_EEEvT_SI_T0_.isra.0)
    *librayopdf_layout.a:tables.cpp.o(.text._ZSt24__merge_sort_with_bufferIN9__gnu_cxx17__normal_iteratorIPZN7RayoPdf6Layout12_GLOBAL__N_18Detector10RuleStacksEvE5StackSt6vectorIS6_SaIS6_EEEES7_NS0_5__ops15_Iter_comp_iterIZNS5_10RuleStacksEvEUlRKS6_SF_E_EEEvT_SI_T0_T1_.isra.0)
    *librayopdf_layout.a:tables.cpp.o(.text._ZN7RayoPdf6Layout12_GLOBAL__N_110InkColumnsERKNS1_3InkEfffRSt6vectorINS1_3GapESaIS6_EE)
    *librayopdf_layout.a:tables.cpp.o(.text._ZSt16__merge_adaptiveIN9__gnu_cxx17__normal_iteratorIPZN7RayoPdf6Layout12_GLOBAL__N_18Detector10RuleStacksEvE5StackSt6vectorIS6_SaIS6_EEEElS7_NS0_5__ops15_Iter_comp_iterIZNS5_10RuleStacksEvEUlRKS6_SF_E_EEEvT_SI_SI_T0_SJ_T1_T2_.isra.0)
    *librayopdf_layout.a:tables.cpp.o(.text._ZSt22__stable_sort_adaptiveIN9__gnu_cxx17__normal_iteratorIPZN7RayoPdf6Layout12_GLOBAL__N_18Detector10RuleStacksEvE5StackSt6vectorIS6_SaIS6_EEEES7_NS0_5__ops15_Iter_comp_iterIZNS5_10RuleStacksEvEUlRKS6_SF_E_EEEvT_SI_SI_T0_T1_.isra.0)
    *librayopdf_layout.a:tables.cpp.o(.text._ZSt13__stable_sortIN9__gnu_cxx17__normal_iteratorIPZN7RayoPdf6Layout12_GLOBAL__N_18Detector10RuleStacksEvE5StackSt6vectorIS6_SaIS6_EEEENS0_5__ops15_Iter_comp_iterIZNS5_10RuleStacksEvEUlRKS6_SF_E_EEEvT_SI_T0_.isra.0)
    *librayopdf_layout.a:tables.cpp.o(.text._ZSt16__introsort_loopIN9__gnu_cxx17__normal_iteratorIPN7RayoPdf6Layout12_GLOBAL__N_14EdgeESt6vectorIS5_SaIS5_EEEElNS0_5__ops15_Iter_comp_iterIZNS4_8Detector10RuleStacksEvEUlRKS5_SF_E_EEEvT_SI_T0_T1_)
    *librayopdf_layout.a:tables.cpp.o(.text._ZN7RayoPdf6Layout12_GLOBAL__N_18Detector7ColumnsERKSt6vectorINS1_3RowESaIS4_EERKS3_IjSaIjEEmmfffRS3_INS1_3GapESaISD_EEPKS3_IhSaIhEE)
    *librayopdf_layout.a:page_pool.cpp.o(.text._ZN7RayoPdf6Layout8PagePool5StartEj)
    *librayopdf_layout.a:reading_order.cpp.o(.text._ZSt16__insertion_sortIN9__gnu_cxx17__normal_iteratorIPjSt6vectorIjSaIjEEEENS0_5__ops15_Iter_comp_iterIZN7RayoPdf6Layout12_GLOBAL__N_17Orderer6SplitYERS5_RS3_ImSaImEEEUljjE_EEEvT_SJ_T0_)
    *librayopdf_layout.a:reading_order.cpp.o(.text._ZSt16__introsort_loopIN9__gnu_cxx17__normal_iteratorIPjSt6vectorIjSaIjEEEElNS0_5__ops15_Iter_comp_iterIZN7RayoPdf6Layout12_GLOBAL__N_17Orderer6SplitYERS5_RS3_ImSaImEEEUljjE_EEEvT_SJ_T0_T1_)
    *librayopdf_layout.a:semantics.cpp.o(.text._ZZN7RayoPdf6Layout11BuildBlocksERKSt6vectorINS0_8PageDataESaIS2_EERKS1_INS0_12OutlineEntryESaIS7_EERKS1_IhSaIhEEbRNS0_9BlockListEENKUlmE4_clEm)
    *librayopdf_text.a:font.cpp.o(.text._ZN7RayoPdf4Text12_GLOBAL__N_113ReadBaseNamesERKNS_8DocumentERKNS1_10DescriptorERNS1_11SimpleNamesE)
    *librayopdf_text.a:font.cpp.o(.text._ZN7RayoPdf4Text12_GLOBAL__N_122FinishSpaceWidthSimpleERNS0_4Font4ImplE)
    *librayopdf_text.a:font.cpp.o(.text._ZN7RayoPdf4Text12_GLOBAL__N_119CompleteSimpleTextsERNS0_4Font4ImplERNS1_10SimpleLoadE)
    *libstdc++.a:thread.o(.text._ZNSt6thread15_M_start_threadESt10unique_ptrINS_6_StateESt14default_deleteIS1_EEPFvvE)
    *librayopdf_layout.a:page_pool.cpp.o(.text._ZNSt6thread11_State_implINS_8_InvokerISt5tupleIJMN7RayoPdf6Layout8PagePoolEFvjEPS5_jEEEEE6_M_runEv)
    *librayopdf_layout.a:page_pool.cpp.o(.text._ZN7RayoPdf6Layout8PagePool5ServeEj)
    *librayopdf_layout.a:structure.cpp.o(.text._ZSt25__unguarded_linear_insertIN9__gnu_cxx17__normal_iteratorIPZN7RayoPdf6Layout12TaggedLayout7PrepareERSt6vectorINS3_8PageDataESaIS6_EERKNS3_9StructureEE4UnitS5_ISD_SaISD_EEEENS0_5__ops14_Val_comp_iterIZNS4_7PrepareES9_SC_EUlRKSD_SL_E_EEEvT_T0_.isra.0)
    *librayopdf_layout.a:structure.cpp.o(.text._ZSt16__insertion_sortIN9__gnu_cxx17__normal_iteratorIPZN7RayoPdf6Layout12TaggedLayout7PrepareERSt6vectorINS3_8PageDataESaIS6_EERKNS3_9StructureEE4UnitS5_ISD_SaISD_EEEENS0_5__ops15_Iter_comp_iterIZNS4_7PrepareES9_SC_EUlRKSD_SL_E_EEEvT_SO_T0_.isra.0)
    *librayopdf_layout.a:structure.cpp.o(.text._ZSt25__unguarded_linear_insertIN9__gnu_cxx17__normal_iteratorIPZN7RayoPdf6Layout12TaggedLayout6LayOutERSt6vectorINS3_8PageDataESaIS6_EEjE5EntryS5_ISA_SaISA_EEEENS0_5__ops14_Val_comp_iterIZNS4_6LayOutES9_jEUlRKSA_SI_E_EEEvT_T0_)
    *librayopdf_layout.a:structure.cpp.o(.text._ZSt16__insertion_sortIN9__gnu_cxx17__normal_iteratorIPZN7RayoPdf6Layout12TaggedLayout6LayOutERSt6vectorINS3_8PageDataESaIS6_EEjE5EntryS5_ISA_SaISA_EEEENS0_5__ops15_Iter_comp_iterIZNS4_6LayOutES9_jEUlRKSA_SI_E_EEEvT_SL_T0_)
    *librayopdf_layout.a:structure.cpp.o(.text._ZSt16__introsort_loopIN9__gnu_cxx17__normal_iteratorIPZN7RayoPdf6Layout12TaggedLayout6LayOutERSt6vectorINS3_8PageDataESaIS6_EEjE5EntryS5_ISA_SaISA_EEEElNS0_5__ops15_Iter_comp_iterIZNS4_6LayOutES9_jEUlRKSA_SI_E_EEEvT_SL_T0_T1_)
    *librayopdf_layout.a:structure.cpp.o(.text._ZSt16__introsort_loopIN9__gnu_cxx17__normal_iteratorIPZN7RayoPdf6Layout12TaggedLayout7PrepareERSt6vectorINS3_8PageDataESaIS6_EERKNS3_9StructureEE4UnitS5_ISD_SaISD_EEEElNS0_5__ops15_Iter_comp_iterIZNS4_7PrepareES9_SC_EUlRKSD_SL_E_EEEvT_SO_T0_T1_)
    *librayopdf_layout.a:structure.cpp.o(.text._ZN7RayoPdf6Layout12_GLOBAL__N_15PieceERKNS0_8PageDataERKSt6vectorIjSaIjEES9_RKNS0_4LineEjRjRmPf.isra.0)
    *librayopdf_layout.a:structure.cpp.o(.text._ZN7RayoPdf6Layout12TaggedLayout12LayOutTablesERNS0_8PageDataEj)
    *librayopdf_layout.a:structure.cpp.o(.text._ZN7RayoPdf6Layout12TaggedLayout6LayOutERSt6vectorINS0_8PageDataESaIS3_EEj)
    *librayopdf_layout.a:structure.cpp.o(.text._ZNSt6vectorIN7RayoPdf6Layout9BlockLineESaIS2_EE17_M_realloc_insertIJS2_EEEvN9__gnu_cxx17__normal_iteratorIPS2_S4_EEDpOT_)
    *librayopdf_layout.a:structure.cpp.o(.text._ZN7RayoPdf6Layout12TaggedLayout6BlocksERKSt6vectorINS0_8PageDataESaIS3_EERNS0_9BlockListE)
    *librayopdf_layout.a:tables.cpp.o(.text._ZNK7RayoPdf6Layout12_GLOBAL__N_18Detector5CharsERKNS1_5TWordE)
    *librayopdf_layout.a:figures.cpp.o(.text._ZN7RayoPdf6Layout13FigureRegionsERNS0_8PageDataERSt6vectorINS0_12FigureRegionESaIS4_EE)
    *libstdc++.a:thread.o(.text.execute_native_thread_routine)
    *librayopdf_layout.a:semantics.cpp.o(.text._ZNSt8__detail9_Map_baseIiSt4pairIKijESaIS3_ENS_10_Select1stESt8equal_toIiESt4hashIiENS_18_Mod_range_hashingENS_20_Default_ranged_hashENS_20_Prime_rehash_policyENS_17_Hashtable_traitsILb0ELb0ELb1EEELb1EEixERS2_)
    *librayopdf_layout.a:semantics.cpp.o(.text._ZNSt8__detail9_Map_baseIiSt4pairIKimESaIS3_ENS_10_Select1stESt8equal_toIiESt4hashIiENS_18_Mod_range_hashingENS_20_Default_ranged_hashENS_20_Prime_rehash_policyENS_17_Hashtable_traitsILb0ELb0ELb1EEELb1EEixERS2_)
    *librayopdf_layout.a:markdown_writer.cpp.o(.text._ZSt16__insertion_sortIN9__gnu_cxx17__normal_iteratorIPN7RayoPdf6Layout12_GLOBAL__N_16Writer9CandidateESt6vectorIS6_SaIS6_EEEENS0_5__ops15_Iter_comp_iterIZNS5_13KnownCompoundERKNS3_8PageDataERKNS3_4LineEjSG_SJ_jEUlRKS6_SL_E_EEEvT_SO_T0_.isra.0)
    *librayopdf_layout.a:markdown_writer.cpp.o(.text._ZSt16__introsort_loopIN9__gnu_cxx17__normal_iteratorIPN7RayoPdf6Layout12_GLOBAL__N_16Writer9CandidateESt6vectorIS6_SaIS6_EEEElNS0_5__ops15_Iter_comp_iterIZNS5_13KnownCompoundERKNS3_8PageDataERKNS3_4LineEjSG_SJ_jEUlRKS6_SL_E_EEEvT_SO_T0_T1_)
    *librayopdf_text.a:cmap.cpp.o(.text._ZSt16__insertion_sortIN9__gnu_cxx17__normal_iteratorIPN7RayoPdf4Text12UnicodeEntryESt6vectorIS4_SaIS4_EEEENS0_5__ops15_Iter_comp_iterIZNS3_14ParseToUnicodeESt17basic_string_viewIcSt11char_traitsIcEERNS3_12ToUnicodeMapEEUlRKS4_SJ_E_EEEvT_SM_T0_.isra.0)
    *librayopdf_text.a:cmap.cpp.o(.text._ZSt24__merge_sort_with_bufferIN9__gnu_cxx17__normal_iteratorIPN7RayoPdf4Text12UnicodeEntryESt6vectorIS4_SaIS4_EEEES5_NS0_5__ops15_Iter_comp_iterIZNS3_14ParseToUnicodeESt17basic_string_viewIcSt11char_traitsIcEERNS3_12ToUnicodeMapEEUlRKS4_SJ_E_EEEvT_SM_T0_T1_.isra.0)
    *librayopdf_text.a:cmap.cpp.o(.text._ZSt16__merge_adaptiveIN9__gnu_cxx17__normal_iteratorIPN7RayoPdf4Text12UnicodeEntryESt6vectorIS4_SaIS4_EEEElS5_NS0_5__ops15_Iter_comp_iterIZNS3_14ParseToUnicodeESt17basic_string_viewIcSt11char_traitsIcEERNS3_12ToUnicodeMapEEUlRKS4_SJ_E_EEEvT_SM_SM_T0_SN_T1_T2_.isra.0)
    *librayopdf_text.a:cmap.cpp.o(.text._ZSt22__stable_sort_adaptiveIN9__gnu_cxx17__normal_iteratorIPN7RayoPdf4Text12UnicodeEntryESt6vectorIS4_SaIS4_EEEES5_NS0_5__ops15_Iter_comp_iterIZNS3_14ParseToUnicodeESt17basic_string_viewIcSt11char_traitsIcEERNS3_12ToUnicodeMapEEUlRKS4_SJ_E_EEEvT_SM_SM_T0_T1_.isra.0)
    *libc.a:pthread_cond_broadcast.o(.text)
    *libc.a:pthread_self.o(.text)
    *libc.a:sched_cpucount.o(.text)
    *libc.a:sched_getaffinity.o(.text)
    *librayopdf_layout.a:pipeline.cpp.o(.text._ZZN7RayoPdf6Layout8PagePool3RunIZNS0_12_GLOBAL__N_111LayOutPagesERSt6vectorINS0_8PageDataESaIS5_EERS1_NS0_8MathModeEEUljmE0_EEvmOT_ENUlPvjmE_4_FUNESE_jm)
    *librayopdf_layout.a:pipeline.cpp.o(.text._ZNSt6vectorItSaItEE17_M_default_appendEm)
    *librayopdf_layout.a:pipeline.cpp.o(.text._ZZN7RayoPdf6Layout8PagePool3RunIZNS0_12_GLOBAL__N_111LayOutPagesERSt6vectorINS0_8PageDataESaIS5_EERS1_NS0_8MathModeEEUljmE_EEvmOT_ENUlPvjmE_4_FUNESE_jm)
    *librayopdf_layout.a:semantics.cpp.o(.text._ZN7RayoPdf6Layout12_GLOBAL__N_112SectionDepthESt17basic_string_viewIcSt11char_traitsIcEE)
    *librayopdf_layout.a:semantics.cpp.o(.text._ZN7RayoPdf6Layout12_GLOBAL__N_112HoldsAddressESt17basic_string_viewIcSt11char_traitsIcEE)
    *librayopdf_layout.a:structure.cpp.o(.text._ZN7RayoPdf6Layout12_GLOBAL__N_16Reader19ReadAttributeObjectERKNS_8PdfValueERNS0_10StructNodeERm)
    *librayopdf_layout.a:tables.cpp.o(.text._ZSt16__insertion_sortIN9__gnu_cxx17__normal_iteratorIPN7RayoPdf6Layout12_GLOBAL__N_14EdgeESt6vectorIS5_SaIS5_EEEENS0_5__ops15_Iter_comp_iterIZNS4_8Detector10RuleStacksEvEUlRKS5_SF_E0_EEEvT_SI_T0_.isra.0)
    *librayopdf_layout.a:tables.cpp.o(.text._ZSt16__introsort_loopIN9__gnu_cxx17__normal_iteratorIPN7RayoPdf6Layout12_GLOBAL__N_14EdgeESt6vectorIS5_SaIS5_EEEElNS0_5__ops15_Iter_comp_iterIZNS4_8Detector10RuleStacksEvEUlRKS5_SF_E0_EEEvT_SI_T0_T1_)
    *librayopdf_layout.a:tables.cpp.o(.text._ZN7RayoPdf6Layout12_GLOBAL__N_112ComputeSpansERNS1_4GridE)
    *librayopdf_layout.a:markdown_writer.cpp.o(.text._ZSt25__unguarded_linear_insertIN9__gnu_cxx17__normal_iteratorIPN7RayoPdf6Layout12_GLOBAL__N_16Writer9CandidateESt6vectorIS6_SaIS6_EEEENS0_5__ops14_Val_comp_iterIZNS5_13KnownCompoundERKNS3_8PageDataERKNS3_4LineEjSG_SJ_jEUlRKS6_SL_E_EEEvT_T0_.isra.0)
    *librayopdf_text.a:font.cpp.o(.text._ZN7RayoPdf4Text12_GLOBAL__N_19FindByCidINS1_10WidthRangeEEEPKT_RKSt6vectorIS4_SaIS4_EEj)
    *librayopdf_text.a:cmap.cpp.o(.text._ZNSt6vectorIN7RayoPdf4Text12UnicodeEntryESaIS2_EE17_M_realloc_insertIJS2_EEEvN9__gnu_cxx17__normal_iteratorIPS2_S4_EEDpOT_)
    *librayopdf_text.a:cmap.cpp.o(.text._ZN7RayoPdf4Text12_GLOBAL__N_111UnicodeSink5RangeEjjRKNS1_5TokenENS1_7SectionE)
    *libstdc++.a:condition_variable.o(.text._ZNSt18condition_variable4waitERSt11unique_lockISt5mutexE)
    *(.text._ZNSt8__detail18__to_chars_10_implIjEEvPcjT_)
    *librayopdf_layout.a:interpreter.cpp.o(.text._ZN7RayoPdf6Layout12_GLOBAL__N_111Interpreter9DoXObjectERKNS_8PdfValueESt17basic_string_viewIcSt11char_traitsIcEEi)
    *librayopdf_layout.a:semantics.cpp.o(.text._ZZN7RayoPdf6Layout11BuildBlocksERKSt6vectorINS0_8PageDataESaIS2_EERKS1_INS0_12OutlineEntryESaIS7_EERKS1_IhSaIhEEbRNS0_9BlockListEENKUljjE0_clEjj)
    *librayopdf_layout.a:tables.cpp.o(.text._ZN7RayoPdf6Layout12_GLOBAL__N_17Locator3RowEf)
    *librayopdf_layout.a:tables.cpp.o(.text._ZN7RayoPdf6Layout12_GLOBAL__N_17Locator6ColumnEf)
    *librayopdf_layout.a:tables.cpp.o(.text._ZZN7RayoPdf6Layout12_GLOBAL__N_18Detector10RuleStacksEvENKUlRmS3_bE_clES3_S3_b)
    *librayopdf_layout.a:tables.cpp.o(.text._ZNK7RayoPdf6Layout12_GLOBAL__N_18Detector18SplitColumnsByTextERNS1_4GridEPKSt6vectorINS1_10LevelLabelESaIS6_EE)
    *librayopdf_text.a:font.cpp.o(.text._ZNK7RayoPdf4Text4Font4Impl5CidOfEjhRj)
    *libstdc++.a:string-inst.o(.text._ZNSt7__cxx1112basic_stringIcSt11char_traitsIcESaIcEE12_M_constructEmc)
    *librayopdf_layout.a:tables.cpp.o(.text._ZN7RayoPdf6Layout12_GLOBAL__N_19CellPlainERKNS0_8PageDataERKNS0_9TableCellERNSt7__cxx1112basic_stringIcSt11char_traitsIcESaIcEEESE_)
    *librayopdf_layout.a:tables.cpp.o(.text._ZN7RayoPdf6Layout14RepeatedHeaderERKNS0_9TablePartES3_)
    *librayopdf_layout.a:tables.cpp.o(.text._ZN7RayoPdf6Layout14TableContinuesERKSt6vectorINS0_8PageDataESaIS2_EERKS1_INS0_9BlockLineESaIS7_EERKNS0_5BlockEjj)
    *librayopdf_layout.a:tables.cpp.o(.text._ZN7RayoPdf6Layout12_GLOBAL__N_18Detector7FiguresEv)
    *librayopdf_text.a:cmap.cpp.o(.text._ZSt12__move_mergeIPN7RayoPdf4Text12UnicodeEntryEN9__gnu_cxx17__normal_iteratorIS3_St6vectorIS2_SaIS2_EEEENS4_5__ops15_Iter_comp_iterIZNS1_14ParseToUnicodeESt17basic_string_viewIcSt11char_traitsIcEERNS1_12ToUnicodeMapEEUlRKS2_SJ_E_EEET0_T_SN_SN_SN_SM_T1_.isra.0)
    *librayopdf_text.a:cmap.cpp.o(.text._ZSt12__move_mergeIN9__gnu_cxx17__normal_iteratorIPN7RayoPdf4Text12UnicodeEntryESt6vectorIS4_SaIS4_EEEES5_NS0_5__ops15_Iter_comp_iterIZNS3_14ParseToUnicodeESt17basic_string_viewIcSt11char_traitsIcEERNS3_12ToUnicodeMapEEUlRKS4_SJ_E_EEET0_T_SN_SN_SN_SM_T1_.isra.0)
    *librayopdf_pdf.a:inflate.cpp.o(.text._ZN7RayoPdf7Inflate6Output4GrowEm)
    *librayopdf_layout.a:reading_order.cpp.o(.text._ZNK7RayoPdf6Layout12_GLOBAL__N_111RunningKeys4FindEcSt17basic_string_viewIcSt11char_traitsIcEE)
    *librayopdf_layout.a:semantics.cpp.o(.text._ZN7RayoPdf6Layout12_GLOBAL__N_17NoteKeyESt17basic_string_viewIcSt11char_traitsIcEE)
    *librayopdf_layout.a:semantics.cpp.o(.text._ZN7RayoPdf6Layout12_GLOBAL__N_114SuperscriptRunERKNS0_8PageDataERKNS0_4LineEjRNSt7__cxx1112basic_stringIcSt11char_traitsIcESaIcEEE)
    *librayopdf_layout.a:semantics.cpp.o(.text._ZZN7RayoPdf6Layout12_GLOBAL__N_19FindNotesERKSt6vectorINS0_8PageDataESaIS3_EERS2_INS1_4InfoESaIS8_EEfRKNS1_5MarksERS2_INS0_7NoteRefESaISF_EEENKUljRKNS0_4LineEE_clEjSL_)
    *librayopdf_layout.a:tables.cpp.o(.text._ZSt25__unguarded_linear_insertIN9__gnu_cxx17__normal_iteratorIPN7RayoPdf6Layout12_GLOBAL__N_14EdgeESt6vectorIS5_SaIS5_EEEENS0_5__ops14_Val_comp_iterIZNS4_10MergeEdgesERS9_EUlRKS5_SF_E_EEEvT_T0_.isra.0)
    *librayopdf_layout.a:tables.cpp.o(.text._ZNSt6vectorIZNK7RayoPdf6Layout12_GLOBAL__N_18Detector18SplitColumnsByTextERNS2_4GridEPKS_INS2_10LevelLabelESaIS6_EEE3InkSaISB_EE17_M_realloc_insertIJSB_EEEvN9__gnu_cxx17__normal_iteratorIPSB_SD_EEDpOT_)
    *librayopdf_layout.a:tables.cpp.o(.text._ZN7RayoPdf6Layout12_GLOBAL__N_18Detector8MarkUsedERKNS1_4GridE)
    *librayopdf_layout.a:tables.cpp.o(.text._ZSt16__insertion_sortIN9__gnu_cxx17__normal_iteratorIPZNK7RayoPdf6Layout12_GLOBAL__N_18Detector18SplitColumnsByTextERNS4_4GridEPKSt6vectorINS4_10LevelLabelESaIS9_EEE3InkS8_ISE_SaISE_EEEENS0_5__ops15_Iter_comp_iterIZNKS5_18SplitColumnsByTextES7_SD_EUlRKSE_SM_E_EEEvT_SP_T0_.isra.0)
    *librayopdf_layout.a:tables.cpp.o(.text._ZSt16__insertion_sortIN9__gnu_cxx17__normal_iteratorIPZNK7RayoPdf6Layout12_GLOBAL__N_18Detector18SplitColumnsByTextERNS4_4GridEPKSt6vectorINS4_10LevelLabelESaIS9_EEE3InkS8_ISE_SaISE_EEEENS0_5__ops15_Iter_comp_iterIZNKS5_18SplitColumnsByTextES7_SD_EUlRKSE_SM_E0_EEEvT_SP_T0_.isra.0)
    *librayopdf_layout.a:tables.cpp.o(.text._ZN7RayoPdf6Layout12_GLOBAL__N_111ParseNumberESt17basic_string_viewIcSt11char_traitsIcEERf)
    *librayopdf_layout.a:tables.cpp.o(.text._ZSt16__introsort_loopIN9__gnu_cxx17__normal_iteratorIPZNK7RayoPdf6Layout12_GLOBAL__N_18Detector18SplitColumnsByTextERNS4_4GridEPKSt6vectorINS4_10LevelLabelESaIS9_EEE3InkS8_ISE_SaISE_EEEElNS0_5__ops15_Iter_comp_iterIZNKS5_18SplitColumnsByTextES7_SD_EUlRKSE_SM_E_EEEvT_SP_T0_T1_)
    *librayopdf_layout.a:tables.cpp.o(.text._ZSt16__introsort_loopIN9__gnu_cxx17__normal_iteratorIPZNK7RayoPdf6Layout12_GLOBAL__N_18Detector18SplitColumnsByTextERNS4_4GridEPKSt6vectorINS4_10LevelLabelESaIS9_EEE3InkS8_ISE_SaISE_EEEElNS0_5__ops15_Iter_comp_iterIZNKS5_18SplitColumnsByTextES7_SD_EUlRKSE_SM_E0_EEEvT_SP_T0_T1_)
    *librayopdf_layout.a:tables.cpp.o(.text._ZNSt6vectorIN7RayoPdf6Layout12_GLOBAL__N_14GridESaIS3_EE12emplace_backIJS3_EEERS3_DpOT_.isra.0)
    *librayopdf_layout.a:tables.cpp.o(.text._ZNK7RayoPdf6Layout12_GLOBAL__N_18Detector11SplitByTextERNS1_4GridE)
    *librayopdf_layout.a:tables.cpp.o(.text._ZNK7RayoPdf6Layout12_GLOBAL__N_18Detector10BoundariesERNS1_4GridERKNS1_9ComponentE)
    *librayopdf_layout.a:tables.cpp.o(.text._ZNK7RayoPdf6Layout12_GLOBAL__N_18Detector16SplitRowsByLinesERNS1_4GridE)
    *librayopdf_layout.a:tables.cpp.o(.text._ZSt16__introsort_loopIN9__gnu_cxx17__normal_iteratorIPfSt6vectorIfSaIfEEEElNS0_5__ops15_Iter_less_iterEEvT_S9_T0_T1_.isra.0)
    *librayopdf_layout.a:tables.cpp.o(.text._ZN7RayoPdf6Layout12_GLOBAL__N_17ClusterERSt6vectorIfSaIfEE)
    *librayopdf_layout.a:tables.cpp.o(.text._ZNK7RayoPdf6Layout12_GLOBAL__N_18Detector20SplitRowsByVerticalsERNS1_4GridERSt6vectorINS1_4EdgeESaIS6_EERb)
    *librayopdf_layout.a:tables.cpp.o(.text._ZNK7RayoPdf6Layout12_GLOBAL__N_18Detector17SplitHeaderLevelsERNS1_4GridERKNS1_9ComponentERSt6vectorINS1_10LevelLabelESaIS9_EE)
    *librayopdf_layout.a:figures.cpp.o(.text._ZN7RayoPdf6Layout9ChartAxesERKNS0_8PageDataERSt6vectorINS0_12FigureRegionESaIS5_EE)
    *librayopdf_text.a:font.cpp.o(.text._ZNSt6vectorIN7RayoPdf4Text12UnicodeEntryESaIS2_EE17_M_default_appendEm)
    *librayopdf_text.a:cmap.cpp.o(.text._ZNSt6vectorIN7RayoPdf4Text10UnicodeRunESaIS2_EE17_M_realloc_insertIJS2_EEEvN9__gnu_cxx17__normal_iteratorIPS2_S4_EEDpOT_)
    *libstdc++.a:string-inst.o(.text._ZNKSt7__cxx1112basic_stringIcSt11char_traitsIcESaIcEE4findEcm)
    *librayopdf_layout.a:interpreter.cpp.o(.text._ZNSt6vectorIN7RayoPdf6Layout8ImageBoxESaIS2_EE17_M_realloc_insertIJRKS2_EEEvN9__gnu_cxx17__normal_iteratorIPS2_S4_EEDpOT_)
    *librayopdf_layout.a:math.cpp.o(.text._ZNSt6vectorImSaImEE17_M_realloc_insertIJmEEEvN9__gnu_cxx17__normal_iteratorIPmS1_EEDpOT_)
    *librayopdf_layout.a:ocr_client.cpp.o(.text._ZNSt7__cxx1112basic_stringIcSt11char_traitsIcESaIcEE12_M_constructIPKcEEvT_S8_St20forward_iterator_tag.isra.0)
    *librayopdf_layout.a:ocr_client.cpp.o(.text._ZNSt7__cxx1112basic_stringIcSt11char_traitsIcESaIcEE12_M_constructIPcEEvT_S7_St20forward_iterator_tag.isra.0)
    *librayopdf_layout.a:ocr_client.cpp.o(.text._ZN7RayoPdf6Layout12_GLOBAL__N_14JoinERKNSt7__cxx1112basic_stringIcSt11char_traitsIcESaIcEEEPKc.constprop.0.isra.0)
    *librayopdf_layout.a:ocr_client.cpp.o(.text._ZN7RayoPdf6Layout12FindOcrAddonERKNSt7__cxx1112basic_stringIcSt11char_traitsIcESaIcEEE)
    *librayopdf_layout.a:ocr_client.cpp.o(.text._ZN7RayoPdf6Layout10OcrSessionC2ERKNS0_10OcrOptionsE)
    *librayopdf_layout.a:ocr_client.cpp.o(.text._ZN7RayoPdf6Layout10OcrSession6EnsureEv)
    *librayopdf_layout.a:ocr_client.cpp.o(.text._ZN7RayoPdf6Layout10OcrSession4QuitEv)
    *librayopdf_layout.a:ocr_client.cpp.o(.text._ZN7RayoPdf6Layout10OcrSessionD2Ev)
    *librayopdf_layout.a:ocr_process.cpp.o(.text._ZNSt7__cxx1112basic_stringIcSt11char_traitsIcESaIcEE12_M_constructIPKcEEvT_S8_St20forward_iterator_tag.isra.0)
    *librayopdf_layout.a:ocr_process.cpp.o(.text._ZNK7RayoPdf6Layout12ChildProcess7RunningEv)
    *librayopdf_layout.a:ocr_process.cpp.o(.text._ZN7RayoPdf6Layout12ChildProcess4KillEv)
    *librayopdf_layout.a:ocr_process.cpp.o(.text._ZN7RayoPdf6Layout12ChildProcessD2Ev)
    *librayopdf_layout.a:ocr_process.cpp.o(.text._ZN7RayoPdf6Layout19ExecutableDirectoryB5cxx11Ev)
    *librayopdf_layout.a:ocr_process.cpp.o(.text._ZN7RayoPdf6Layout16EnvironmentValueB5cxx11EPKc)
    *librayopdf_layout.a:ocr_process.cpp.o(.text._ZN7RayoPdf6Layout16IsExecutableFileERKNSt7__cxx1112basic_stringIcSt11char_traitsIcESaIcEEE)
    *librayopdf_layout.a:ocr_style.cpp.o(.text._ZNSt6vectorItSaItEE14_M_fill_insertEN9__gnu_cxx17__normal_iteratorIPtS1_EEmRKt)
    *librayopdf_layout.a:reading_order.cpp.o(.text._ZN7RayoPdf6Layout12_GLOBAL__N_17Orderer11ColumnsLikeERKSt6vectorIjSaIjEERKS3_ImSaImEEf.isra.0)
    *librayopdf_layout.a:semantics.cpp.o(.text._ZSt16__insertion_sortIN9__gnu_cxx17__normal_iteratorIPiSt6vectorIiSaIiEEEENS0_5__ops15_Iter_comp_iterISt7greaterIiEEEEvT_SC_T0_.isra.0)
    *librayopdf_layout.a:semantics.cpp.o(.text._ZSt16__insertion_sortIN9__gnu_cxx17__normal_iteratorIPN7RayoPdf6Layout7NoteRefESt6vectorIS4_SaIS4_EEEENS0_5__ops15_Iter_comp_iterIZNS3_12_GLOBAL__N_19FindNotesERKS6_INS3_8PageDataESaISD_EERS6_INSC_4InfoESaISI_EEfRKNSC_5MarksERS8_EUlRKS4_SR_E_EEEvT_SU_T0_.isra.0)
    *librayopdf_layout.a:semantics.cpp.o(.text._ZNSt6vectorIZN7RayoPdf6Layout12_GLOBAL__N_19FindNotesERKS_INS1_8PageDataESaIS3_EERS_INS2_4InfoESaIS8_EEfRKNS2_5MarksERS_INS1_7NoteRefESaISF_EEE3RefSaISJ_EE12emplace_backIJSJ_EEERSJ_DpOT_.constprop.0.isra.0)
    *librayopdf_layout.a:semantics.cpp.o(.text._ZSt16__introsort_loopIN9__gnu_cxx17__normal_iteratorIPSt4pairIfjESt6vectorIS3_SaIS3_EEEElNS0_5__ops15_Iter_less_iterEEvT_SB_T0_T1_.isra.0)
    *librayopdf_layout.a:semantics.cpp.o(.text._ZSt16__insertion_sortIN9__gnu_cxx17__normal_iteratorIPSt4pairIfjESt6vectorIS3_SaIS3_EEEENS0_5__ops15_Iter_less_iterEEvT_SB_T0_.isra.0)
    *librayopdf_layout.a:semantics.cpp.o(.text._ZN7RayoPdf6Layout12_GLOBAL__N_111FrontMatterESt17basic_string_viewIcSt11char_traitsIcEE)
    *librayopdf_layout.a:semantics.cpp.o(.text._ZSt16__insertion_sortIN9__gnu_cxx17__normal_iteratorIPjSt6vectorIjSaIjEEEENS0_5__ops15_Iter_comp_iterIZN7RayoPdf6Layout12_GLOBAL__N_110PlaceNotesERKS3_INSA_8PageDataESaISC_EERS3_INSA_5BlockESaISH_EERKS3_INSA_9BlockLineESaISL_EERKSJ_RKS3_INSA_7NoteRefESaISS_EEEUljjE_EEEvT_SZ_T0_)
    *librayopdf_layout.a:semantics.cpp.o(.text._ZSt24__merge_sort_with_bufferIN9__gnu_cxx17__normal_iteratorIPjSt6vectorIjSaIjEEEES2_NS0_5__ops15_Iter_comp_iterIZN7RayoPdf6Layout12_GLOBAL__N_110PlaceNotesERKS3_INSA_8PageDataESaISC_EERS3_INSA_5BlockESaISH_EERKS3_INSA_9BlockLineESaISL_EERKSJ_RKS3_INSA_7NoteRefESaISS_EEEUljjE_EEEvT_SZ_T0_T1_)
    *librayopdf_layout.a:semantics.cpp.o(.text._ZSt16__introsort_loopIN9__gnu_cxx17__normal_iteratorIPN7RayoPdf6Layout7NoteRefESt6vectorIS4_SaIS4_EEEElNS0_5__ops15_Iter_comp_iterIZNS3_12_GLOBAL__N_19FindNotesERKS6_INS3_8PageDataESaISD_EERS6_INSC_4InfoESaISI_EEfRKNSC_5MarksERS8_EUlRKS4_SR_E_EEEvT_SU_T0_T1_)
    *librayopdf_layout.a:semantics.cpp.o(.text._ZSt16__merge_adaptiveIN9__gnu_cxx17__normal_iteratorIPjSt6vectorIjSaIjEEEElS2_NS0_5__ops15_Iter_comp_iterIZN7RayoPdf6Layout12_GLOBAL__N_110PlaceNotesERKS3_INSA_8PageDataESaISC_EERS3_INSA_5BlockESaISH_EERKS3_INSA_9BlockLineESaISL_EERKSJ_RKS3_INSA_7NoteRefESaISS_EEEUljjE_EEEvT_SZ_SZ_T0_S10_T1_T2_)
    *librayopdf_layout.a:semantics.cpp.o(.text._ZSt22__stable_sort_adaptiveIN9__gnu_cxx17__normal_iteratorIPjSt6vectorIjSaIjEEEES2_NS0_5__ops15_Iter_comp_iterIZN7RayoPdf6Layout12_GLOBAL__N_110PlaceNotesERKS3_INSA_8PageDataESaISC_EERS3_INSA_5BlockESaISH_EERKS3_INSA_9BlockLineESaISL_EERKSJ_RKS3_INSA_7NoteRefESaISS_EEEUljjE_EEEvT_SZ_SZ_T0_T1_)
    *librayopdf_layout.a:semantics.cpp.o(.text._ZNSt10_HashtableIjSt4pairIKjSt6vectorIjSaIjEEESaIS5_ENSt8__detail10_Select1stESt8equal_toIjESt4hashIjENS7_18_Mod_range_hashingENS7_20_Default_ranged_hashENS7_20_Prime_rehash_policyENS7_17_Hashtable_traitsILb0ELb0ELb1EEEE21_M_insert_unique_nodeEmmPNS7_10_Hash_nodeIS5_Lb0EEEm)
    *librayopdf_layout.a:semantics.cpp.o(.text._ZNSt6vectorIN7RayoPdf6Layout7NoteRefESaIS2_EE17_M_realloc_insertIJS2_EEEvN9__gnu_cxx17__normal_iteratorIPS2_S4_EEDpOT_)
    *librayopdf_layout.a:semantics.cpp.o(.text._ZSt16__introsort_loopIN9__gnu_cxx17__normal_iteratorIPiSt6vectorIiSaIiEEEElNS0_5__ops15_Iter_comp_iterISt7greaterIiEEEEvT_SC_T0_T1_)
    *librayopdf_layout.a:structure.cpp.o(.text._ZSt16__introsort_loopIN9__gnu_cxx17__normal_iteratorIPjSt6vectorIjSaIjEEEElNS0_5__ops15_Iter_less_iterEEvT_S9_T0_T1_.isra.0)
    *librayopdf_layout.a:structure.cpp.o(.text._ZSt25__unguarded_linear_insertIN9__gnu_cxx17__normal_iteratorIPZN7RayoPdf6Layout12TaggedLayout12LayOutTablesERNS3_8PageDataEjE5EntrySt6vectorIS7_SaIS7_EEEENS0_5__ops14_Val_comp_iterIZNS4_12LayOutTablesES6_jEUlRKS7_SG_E_EEEvT_T0_)
    *librayopdf_layout.a:structure.cpp.o(.text._ZSt16__insertion_sortIN9__gnu_cxx17__normal_iteratorIPjSt6vectorIjSaIjEEEENS0_5__ops15_Iter_less_iterEEvT_S9_T0_.isra.0)
    *librayopdf_layout.a:structure.cpp.o(.text._ZSt16__insertion_sortIN9__gnu_cxx17__normal_iteratorIPZN7RayoPdf6Layout12TaggedLayout12LayOutTablesERNS3_8PageDataEjE5EntrySt6vectorIS7_SaIS7_EEEENS0_5__ops15_Iter_comp_iterIZNS4_12LayOutTablesES6_jEUlRKS7_SG_E_EEEvT_SJ_T0_)
    *librayopdf_layout.a:structure.cpp.o(.text._ZSt16__introsort_loopIN9__gnu_cxx17__normal_iteratorIPZN7RayoPdf6Layout12TaggedLayout12LayOutTablesERNS3_8PageDataEjE5EntrySt6vectorIS7_SaIS7_EEEElNS0_5__ops15_Iter_comp_iterIZNS4_12LayOutTablesES6_jEUlRKS7_SG_E_EEEvT_SJ_T0_T1_)
    *librayopdf_layout.a:structure.cpp.o(.text._ZNSt6vectorIN7RayoPdf6Layout12TaggedLayout9TableInfoESaIS3_EE17_M_realloc_insertIJS3_EEEvN9__gnu_cxx17__normal_iteratorIPS3_S5_EEDpOT_)
    *librayopdf_layout.a:tables.cpp.o(.text._ZN7RayoPdf6Layout12_GLOBAL__N_19KeepsGapsERKSt6vectorINS1_3GapESaIS3_EES7_)
    *librayopdf_layout.a:tables.cpp.o(.text._ZSt25__unguarded_linear_insertIN9__gnu_cxx17__normal_iteratorIPN7RayoPdf6Layout12_GLOBAL__N_14EdgeESt6vectorIS5_SaIS5_EEEENS0_5__ops14_Val_comp_iterIZNS4_10MergeEdgesERS9_EUlRKS5_SF_E0_EEEvT_T0_.isra.0)
    *librayopdf_layout.a:tables.cpp.o(.text._ZSt25__unguarded_linear_insertIN9__gnu_cxx17__normal_iteratorIPZN7RayoPdf6Layout12_GLOBAL__N_18Detector6CommitEvE5PieceSt6vectorIS6_SaIS6_EEEENS0_5__ops14_Val_comp_iterIZNS5_6CommitEvEUlRKS6_SF_E_EEEvT_T0_)
    *librayopdf_layout.a:tables.cpp.o(.text._ZSt16__insertion_sortIN9__gnu_cxx17__normal_iteratorIPZN7RayoPdf6Layout12_GLOBAL__N_18Detector6CommitEvE5PieceSt6vectorIS6_SaIS6_EEEENS0_5__ops15_Iter_comp_iterIZNS5_6CommitEvEUlRKS6_SF_E_EEEvT_SI_T0_)
    *librayopdf_layout.a:tables.cpp.o(.text._ZSt16__introsort_loopIN9__gnu_cxx17__normal_iteratorIPZN7RayoPdf6Layout12_GLOBAL__N_18Detector6CommitEvE5PieceSt6vectorIS6_SaIS6_EEEElNS0_5__ops15_Iter_comp_iterIZNS5_6CommitEvEUlRKS6_SF_E_EEEvT_SI_T0_T1_)
    *librayopdf_text.a:repair.cpp.o(.text._ZN7RayoPdf4Text6Repair15SymbolCodePointEjRKNS1_7ContextE)
    *librayopdf_common.a:robust.cpp.o(.text._ZN7RayoPdf6Robust14FisherClustersEPKfPKjmifPh)
    *libstdc++.a:string-inst.o(.text._ZNKSt7__cxx1112basic_stringIcSt11char_traitsIcESaIcEE5rfindEcm)
    *librayopdf_layout.a:ocr_style.cpp.o(.text._ZNSt6vectorIN7RayoPdf6Layout6RulingESaIS2_EE17_M_realloc_insertIJRKS2_EEEvN9__gnu_cxx17__normal_iteratorIPS2_S4_EEDpOT_)
    *librayopdf_layout.a:reading_order.cpp.o(.text._ZSt16__insertion_sortIN9__gnu_cxx17__normal_iteratorIPjSt6vectorIjSaIjEEEENS0_5__ops15_Iter_comp_iterIZN7RayoPdf6Layout12_GLOBAL__N_17Orderer8FallbackERS5_EUljjE_EEEvT_SG_T0_)
    *librayopdf_layout.a:reading_order.cpp.o(.text._ZSt16__introsort_loopIN9__gnu_cxx17__normal_iteratorIPjSt6vectorIjSaIjEEEElNS0_5__ops15_Iter_comp_iterIZN7RayoPdf6Layout12_GLOBAL__N_17Orderer8FallbackERS5_EUljjE_EEEvT_SG_T0_T1_)
    *librayopdf_layout.a:tables.cpp.o(.text._ZSt16__introsort_loopIN9__gnu_cxx17__normal_iteratorIPjSt6vectorIjSaIjEEEElNS0_5__ops15_Iter_comp_iterIZN7RayoPdf6Layout12_GLOBAL__N_112CollectEdgesERKNSA_8PageDataEhRS3_INSB_4EdgeESaISF_EESI_EUljjE_EEEvT_SL_T0_T1_)
    *librayopdf_layout.a:tables.cpp.o(.text._ZSt16__insertion_sortIN9__gnu_cxx17__normal_iteratorIPjSt6vectorIjSaIjEEEENS0_5__ops15_Iter_comp_iterIZN7RayoPdf6Layout12_GLOBAL__N_112CollectEdgesERKNSA_8PageDataEhRS3_INSB_4EdgeESaISF_EESI_EUljjE_EEEvT_SL_T0_)
    *librayopdf_layout.a:tables.cpp.o(.text._ZSt16__insertion_sortIN9__gnu_cxx17__normal_iteratorIPN7RayoPdf6Layout12_GLOBAL__N_14EdgeESt6vectorIS5_SaIS5_EEEENS0_5__ops15_Iter_comp_iterIZNKS4_8Detector20SplitRowsByVerticalsERNS4_4GridERS9_RbEUlRKS5_SJ_E_EEEvT_SM_T0_.isra.0)
    *librayopdf_layout.a:tables.cpp.o(.text._ZNK7RayoPdf6Layout12_GLOBAL__N_18Detector9FirstByteERKNS1_5TWordE.isra.0)
    *librayopdf_layout.a:tables.cpp.o(.text._ZSt16__introsort_loopIN9__gnu_cxx17__normal_iteratorIPN7RayoPdf6Layout12_GLOBAL__N_14EdgeESt6vectorIS5_SaIS5_EEEElNS0_5__ops15_Iter_comp_iterIZNKS4_8Detector20SplitRowsByVerticalsERNS4_4GridERS9_RbEUlRKS5_SJ_E_EEEvT_SM_T0_T1_)
    *librayopdf_layout.a:tables.cpp.o(.text._ZNK7RayoPdf6Layout12_GLOBAL__N_18Detector11WordColumnsERKSt6vectorINS1_3RowESaIS4_EERKS3_IjSaIjEEmmRKS3_INS1_3GapESaISD_EERS3_IiSaIiEE.part.0.isra.0)
    *librayopdf_layout.a:tables.cpp.o(.text._ZN7RayoPdf6Layout12_GLOBAL__N_18Detector5TextyERKSt6vectorINS1_3RowESaIS4_EERKS3_IjSaIjEEmmRKS3_INS1_3GapESaISD_EEfb)
    *libc.a:pthread_create.o(.text)
    *libc.a:pthread_getattr_default_np.o(.text)
    *libc.a:getpagesize.o(.text)
    *libc.a:clone-internal.o(.text)
    *libc.a:clone3.o(.text)
    *libc.a:libc_sigaction.o(.text)
    *libc.a:cancellation.o(.text)
    *libc.a:nptl-stack.o(.text)
    *libc.a:pthread_attr_copy.o(.text)
    *libc.a:pthread_attr_destroy.o(.text)
    *libc.a:clone.o(.text)
    *librayopdf_layout.a:reading_order.cpp.o(.text._ZN7RayoPdf6Layout12_GLOBAL__N_17Orderer12SplitAtRulesERSt6vectorIjSaIjEERS3_ImSaImEE)
    *librayopdf_layout.a:semantics.cpp.o(.text._ZN7RayoPdf6Layout12_GLOBAL__N_19FoldLatinEj)
    *librayopdf_layout.a:semantics.cpp.o(.text._ZSt25__unguarded_linear_insertIN9__gnu_cxx17__normal_iteratorIPN7RayoPdf6Layout7NoteRefESt6vectorIS4_SaIS4_EEEENS0_5__ops14_Val_comp_iterIZNS3_12_GLOBAL__N_19FindNotesERKS6_INS3_8PageDataESaISD_EERS6_INSC_4InfoESaISI_EEfRKNSC_5MarksERS8_EUlRKS4_SR_E_EEEvT_T0_.isra.0)
    *librayopdf_layout.a:semantics.cpp.o(.text._ZN7RayoPdf6Layout12_GLOBAL__N_112StartsFoldedESt17basic_string_viewIcSt11char_traitsIcEES5_)
    *librayopdf_layout.a:semantics.cpp.o(.text._ZN7RayoPdf6Layout12_GLOBAL__N_110MathSymbolESt17basic_string_viewIcSt11char_traitsIcEE)
    *librayopdf_layout.a:tables.cpp.o(.text._ZSt25__unguarded_linear_insertIN9__gnu_cxx17__normal_iteratorIPN7RayoPdf6Layout12_GLOBAL__N_14EdgeESt6vectorIS5_SaIS5_EEEENS0_5__ops14_Val_comp_iterIZNKS4_8Detector20SplitRowsByVerticalsERNS4_4GridERS9_RbEUlRKS5_SJ_E_EEEvT_T0_.isra.0)
    *librayopdf_layout.a:tables.cpp.o(.text._ZSt16__insertion_sortIN9__gnu_cxx17__normal_iteratorIPZNK7RayoPdf6Layout12_GLOBAL__N_18Detector17SplitHeaderLevelsERNS4_4GridERKNS4_9ComponentERSt6vectorINS4_10LevelLabelESaISC_EEE4WordSB_ISG_SaISG_EEEENS0_5__ops15_Iter_comp_iterIZNKS5_17SplitHeaderLevelsES7_SA_SF_EUlRKSG_SO_E_EEEvT_SR_T0_.isra.0)
    *librayopdf_layout.a:tables.cpp.o(.text._ZSt13__upper_boundIN9__gnu_cxx17__normal_iteratorIPfSt6vectorIfSaIfEEEEfNS0_5__ops14_Val_less_iterEET_S9_S9_RKT0_T1_.isra.0)
    *librayopdf_layout.a:tables.cpp.o(.text._ZSt16__insertion_sortIN9__gnu_cxx17__normal_iteratorIPN7RayoPdf6Layout12_GLOBAL__N_14EdgeESt6vectorIS5_SaIS5_EEEENS0_5__ops15_Iter_comp_iterIZNS4_8Detector10RuleStacksEvEUlRKS5_SF_E1_EEEvT_SI_T0_.isra.0)
    *librayopdf_layout.a:tables.cpp.o(.text._ZNSt6vectorIhSaIhEE15_M_range_insertIN9__gnu_cxx17__normal_iteratorIPhS1_EEEEvS6_T_S7_St20forward_iterator_tag.isra.0)
    *librayopdf_layout.a:tables.cpp.o(.text._ZSt16__introsort_loopIN9__gnu_cxx17__normal_iteratorIPZNK7RayoPdf6Layout12_GLOBAL__N_18Detector17SplitHeaderLevelsERNS4_4GridERKNS4_9ComponentERSt6vectorINS4_10LevelLabelESaISC_EEE4WordSB_ISG_SaISG_EEEElNS0_5__ops15_Iter_comp_iterIZNKS5_17SplitHeaderLevelsES7_SA_SF_EUlRKSG_SO_E_EEEvT_SR_T0_T1_)
    *librayopdf_layout.a:tables.cpp.o(.text._ZSt16__introsort_loopIN9__gnu_cxx17__normal_iteratorIPN7RayoPdf6Layout12_GLOBAL__N_14EdgeESt6vectorIS5_SaIS5_EEEElNS0_5__ops15_Iter_comp_iterIZNS4_8Detector10RuleStacksEvEUlRKS5_SF_E1_EEEvT_SI_T0_T1_)
    *librayopdf_layout.a:tables.cpp.o(.text._ZN7RayoPdf6Layout12_GLOBAL__N_18Detector8ValidateERNS1_4GridEbPb)
    *librayopdf_text.a:font.cpp.o(.text._ZN7RayoPdf4Text12_GLOBAL__N_17SetSlotERNS0_4Font4ImplEhSt17basic_string_viewIcSt11char_traitsIcEENS0_13UnicodeSourceE)
    *librayopdf_text.a:repair.cpp.o(.text._ZN7RayoPdf4Text6Repair10RepairTextESt17basic_string_viewIcSt11char_traitsIcEERKNS1_7ContextERNSt7__cxx1112basic_stringIcS4_SaIcEEE)
    *librayopdf_pdf.a:document.cpp.o(.text._ZN7RayoPdf8Document4Impl7ResolveERKNS_8PdfValueE)
    *librayopdf_pdf.a:syntax.cpp.o(.text._ZN7RayoPdf6Syntax12_GLOBAL__N_110DecodeNameERNS0_7BuilderESt17basic_string_viewIcSt11char_traitsIcEERS7_)
    *libstdc++.a:del_opv.o(.text._ZdaPv)
    *libstdc++.a:new_opv.o(.text._Znam)
    *libstdc++.a:string-inst.o(.text._ZNSt7__cxx1112basic_stringIcSt11char_traitsIcESaIcEE8_M_eraseEmm)
    *libc.a:_itoa.o(.text)
    *libc.a:vsnprintf.o(.text)
    *libc.a:strchrnul-avx2.o(.text.avx)
    *libc.a:printf_buffer_done.o(.text)
    *libc.a:printf_buffer_write.o(.text)
    *libc.a:snprintf.o(.text)
    *libc.a:vfprintf-internal.o(.text)
    *librayopdf_layout.a:tables.cpp.o(.text._ZSt25__unguarded_linear_insertIN9__gnu_cxx17__normal_iteratorIPZNK7RayoPdf6Layout12_GLOBAL__N_18Detector17SplitHeaderLevelsERNS4_4GridERKNS4_9ComponentERSt6vectorINS4_10LevelLabelESaISC_EEE4WordSB_ISG_SaISG_EEEENS0_5__ops14_Val_comp_iterIZNKS5_17SplitHeaderLevelsES7_SA_SF_EUlRKSG_SO_E_EEEvT_T0_.isra.0)
    *librayopdf_layout.a:tables.cpp.o(.text._ZSt13__upper_boundIN9__gnu_cxx17__normal_iteratorIPKfSt6vectorIfSaIfEEEEfNS0_5__ops14_Val_less_iterEET_SA_SA_RKT0_T1_.isra.0)
    *librayopdf_layout.a:tables.cpp.o(.text._ZNK7RayoPdf6Layout12_GLOBAL__N_18Detector11LineColumnsERKNS1_3RowERKSt6vectorIjSaIjEERKNS1_4GridE)
    *librayopdf_layout.a:tables.cpp.o(.text._ZN7RayoPdf6Layout12_GLOBAL__N_18Detector8ListLikeERKSt6vectorINS1_3RowESaIS4_EERKS3_IjSaIjEEmmRKS3_INS1_3GapESaISD_EE)
    *librayopdf_layout.a:tables.cpp.o(.text._ZNK7RayoPdf6Layout12_GLOBAL__N_18Detector13LatticeHeaderERNS1_4GridE)
    *librayopdf_layout.a:markdown_writer.cpp.o(.text._ZN7RayoPdf6Layout12_GLOBAL__N_110HyphenTextESt17basic_string_viewIcSt11char_traitsIcEE)
    *librayopdf_layout.a:markdown_writer.cpp.o(.text._ZZN7RayoPdf6Layout12_GLOBAL__N_16Writer10StyleWordsEbENKUlmE1_clEm.isra.0)
    *librayopdf_text.a:font.cpp.o(.text._ZN7RayoPdf4Text12_GLOBAL__N_115StandardFontForESt17basic_string_viewIcSt11char_traitsIcEERKNS0_9FontStyleE)
    *librayopdf_text.a:font.cpp.o(.text._ZNSt6vectorISt17basic_string_viewIcSt11char_traitsIcEESaIS3_EE17_M_realloc_insertIJS3_EEEvN9__gnu_cxx17__normal_iteratorIPS3_S5_EEDpOT_)
    *librayopdf_text.a:tables.cpp.o(.text._ZN7RayoPdf4Text6Tables13StandardWidthEitRt)
    *libstdc++.a:string-inst.o(.text._ZNKSt7__cxx1112basic_stringIcSt11char_traitsIcESaIcEE5rfindEPKcmm)
    *libc.a:lowlevellock.o(.text)
    *librayopdf_layout.a:semantics.cpp.o(.text._ZN7RayoPdf6Layout12_GLOBAL__N_111FirstWordIsESt17basic_string_viewIcSt11char_traitsIcEES5_)
    *librayopdf_layout.a:semantics.cpp.o(.text._ZN7RayoPdf6Layout12_GLOBAL__N_19BlockTextERKSt6vectorINS0_8PageDataESaIS3_EERKS2_INS0_9BlockLineESaIS8_EERKNS0_5BlockERNSt7__cxx1112basic_stringIcSt11char_traitsIcESaIcEEESM_)
    *librayopdf_layout.a:tables.cpp.o(.text._ZSt25__unguarded_linear_insertIN9__gnu_cxx17__normal_iteratorIPZNK7RayoPdf6Layout12_GLOBAL__N_18Detector20SplitRowsByVerticalsERNS4_4GridERSt6vectorINS4_4EdgeESaIS9_EERbE5PieceS8_ISE_SaISE_EEEENS0_5__ops14_Val_comp_iterIZNKS5_20SplitRowsByVerticalsES7_SC_SD_EUlRKSE_SM_E0_EEEvT_T0_.isra.0)
    *librayopdf_layout.a:tables.cpp.o(.text._ZSt25__unguarded_linear_insertIN9__gnu_cxx17__normal_iteratorIPZNK7RayoPdf6Layout12_GLOBAL__N_18Detector20SplitRowsByVerticalsERNS4_4GridERSt6vectorINS4_4EdgeESaIS9_EERbE5PieceS8_ISE_SaISE_EEEENS0_5__ops14_Val_comp_iterIZNKS5_20SplitRowsByVerticalsES7_SC_SD_EUlRKSE_SM_E_EEEvT_T0_.isra.0)
    *librayopdf_layout.a:tables.cpp.o(.text._ZSt16__insertion_sortIN9__gnu_cxx17__normal_iteratorIPZNK7RayoPdf6Layout12_GLOBAL__N_18Detector20SplitRowsByVerticalsERNS4_4GridERSt6vectorINS4_4EdgeESaIS9_EERbE5PieceS8_ISE_SaISE_EEEENS0_5__ops15_Iter_comp_iterIZNKS5_20SplitRowsByVerticalsES7_SC_SD_EUlRKSE_SM_E_EEEvT_SP_T0_.isra.0)
    *librayopdf_layout.a:tables.cpp.o(.text._ZSt16__introsort_loopIN9__gnu_cxx17__normal_iteratorIPZNK7RayoPdf6Layout12_GLOBAL__N_18Detector20SplitRowsByVerticalsERNS4_4GridERSt6vectorINS4_4EdgeESaIS9_EERbE5PieceS8_ISE_SaISE_EEEElNS0_5__ops15_Iter_comp_iterIZNKS5_20SplitRowsByVerticalsES7_SC_SD_EUlRKSE_SM_E_EEEvT_SP_T0_T1_)
    *librayopdf_layout.a:tables.cpp.o(.text._ZSt16__introsort_loopIN9__gnu_cxx17__normal_iteratorIPZNK7RayoPdf6Layout12_GLOBAL__N_18Detector20SplitRowsByVerticalsERNS4_4GridERSt6vectorINS4_4EdgeESaIS9_EERbE5PieceS8_ISE_SaISE_EEEElNS0_5__ops15_Iter_comp_iterIZNKS5_20SplitRowsByVerticalsES7_SC_SD_EUlRKSE_SM_E0_EEEvT_SP_T0_T1_)
    *librayopdf_layout.a:tables.cpp.o(.text._ZSt16__insertion_sortIN9__gnu_cxx17__normal_iteratorIPZNK7RayoPdf6Layout12_GLOBAL__N_18Detector20SplitRowsByVerticalsERNS4_4GridERSt6vectorINS4_4EdgeESaIS9_EERbE5PieceS8_ISE_SaISE_EEEENS0_5__ops15_Iter_comp_iterIZNKS5_20SplitRowsByVerticalsES7_SC_SD_EUlRKSE_SM_E0_EEEvT_SP_T0_.isra.0)
    *librayopdf_layout.a:tables.cpp.o(.text._ZNSt6vectorIfSaIfEEaSERKS1_.isra.0)
    *librayopdf_layout.a:lines.cpp.o(.text._ZNSt6vectorIjSaIjEE15_M_range_insertIPjEEvN9__gnu_cxx17__normal_iteratorIS3_S1_EET_S7_St20forward_iterator_tag.isra.0)
    *libc.a:pthread_cond_wait.o(.text)
    *libc.a:cleanup_compat.o(.text)
    *libc.a:futex-internal.o(.text)
    *librayopdf_layout.a:interpreter.cpp.o(.text._ZNSt5dequeINSt7__cxx1112basic_stringIcSt11char_traitsIcESaIcEEESaIS5_EE17_M_default_appendEm)
    *librayopdf_layout.a:structure.cpp.o(.text._ZSt16__insertion_sortIN9__gnu_cxx17__normal_iteratorIPfSt6vectorIfSaIfEEEENS0_5__ops15_Iter_less_iterEEvT_S9_T0_.isra.0)
    *librayopdf_layout.a:structure.cpp.o(.text._ZSt16__introsort_loopIN9__gnu_cxx17__normal_iteratorIPfSt6vectorIfSaIfEEEElNS0_5__ops15_Iter_less_iterEEvT_S9_T0_T1_.isra.0)
    *librayopdf_layout.a:structure.cpp.o(.text._ZZN7RayoPdf6Layout12TaggedLayout6BlocksERKSt6vectorINS0_8PageDataESaIS3_EERNS0_9BlockListEENKUljfE_clEjf)
    *librayopdf_layout.a:structure.cpp.o(.text._ZSt13binary_searchIN9__gnu_cxx17__normal_iteratorIPjSt6vectorIjSaIjEEEEjEbT_S7_RKT0_)
    *librayopdf_layout.a:structure.cpp.o(.text._ZNSt6vectorIN7RayoPdf6Layout7NoteRefESaIS2_EE17_M_realloc_insertIJRKS2_EEEvN9__gnu_cxx17__normal_iteratorIPS2_S4_EEDpOT_)
    *librayopdf_layout.a:tables.cpp.o(.text._ZZN7RayoPdf6Layout12_GLOBAL__N_18Detector10RuleStacksEvENKUlfE_clEf)
    *librayopdf_layout.a:figures.cpp.o(.text._ZNSt6vectorIN7RayoPdf6Layout12FigureRegionESaIS2_EE17_M_realloc_insertIJS2_EEEvN9__gnu_cxx17__normal_iteratorIPS2_S4_EEDpOT_)
    *librayopdf_pdf.a:document.cpp.o(.text._ZZN7RayoPdf8Document4Impl14ReadXrefStreamEmRNS_8PdfValueEENKUlllE_clEll)
    *librayopdf_pdf.a:document.cpp.o(.text._ZN7RayoPdf8Document4Impl14ReadXrefStreamEmRNS_8PdfValueE)
    *libm-*.a:w_log.o(.text)
    *libm-*.a:e_logf-fma.o(.text)
    *libm-*.a:e_log-fma.o(.text.fma)
    *libc.a:fstatat64.o(.text)
    *libc.a:readlink.o(.text)
    *libc.a:stat64.o(.text)
    *librayopdf_layout.a:tables.cpp.o(.text._ZSt16__introsort_loopIN9__gnu_cxx17__normal_iteratorIPjSt6vectorIjSaIjEEEElNS0_5__ops15_Iter_comp_iterIZN7RayoPdf6Layout12_GLOBAL__N_18Detector9BuildRowsEffffRS3_INSB_3RowESaISD_EERS5_EUljjE_EEEvT_SK_T0_T1_)
    *librayopdf_layout.a:tables.cpp.o(.text._ZNSt6vectorIN7RayoPdf6Layout12_GLOBAL__N_110MiddleCellESaIS3_EE6resizeEm)
    *librayopdf_layout.a:tables.cpp.o(.text._ZSt16__insertion_sortIN9__gnu_cxx17__normal_iteratorIPjSt6vectorIjSaIjEEEENS0_5__ops15_Iter_comp_iterIZN7RayoPdf6Layout12_GLOBAL__N_18Detector9BuildRowsEffffRS3_INSB_3RowESaISD_EERS5_EUljjE_EEEvT_SK_T0_)
    *librayopdf_layout.a:tables.cpp.o(.text._ZN7RayoPdf6Layout12_GLOBAL__N_14GridD2Ev)
    *librayopdf_layout.a:tables.cpp.o(.text._ZNSt6vectorIfSaIfEE7reserveEm)
    *librayopdf_layout.a:tables.cpp.o(.text._ZZN7RayoPdf6Layout12_GLOBAL__N_18Detector8TextGridERKSt6vectorINS1_3RowESaIS4_EERKS3_IjSaIjEEmmRKS3_INS1_3GapESaISD_EENS0_9TableKindEtffPKS3_IhSaIhEESM_PKS3_INS1_4EdgeESaISN_EEPKS3_IfSaIfEEENKUlmmE0_clEmm)
    *librayopdf_layout.a:tables.cpp.o(.text._ZN7RayoPdf6Layout12_GLOBAL__N_18Detector8TextGridERKSt6vectorINS1_3RowESaIS4_EERKS3_IjSaIjEEmmRKS3_INS1_3GapESaISD_EENS0_9TableKindEtffPKS3_IhSaIhEESM_PKS3_INS1_4EdgeESaISN_EEPKS3_IfSaIfEE)
    *librayopdf_layout.a:tables.cpp.o(.text._ZN7RayoPdf6Layout12_GLOBAL__N_18Detector10FigureTextERKSt6vectorINS1_3RowESaIS4_EERKS3_IjSaIjEEmmf)
    *librayopdf_layout.a:lines.cpp.o(.text._ZN7RayoPdf6Layout12_GLOBAL__N_114ToLogicalOrderERNS0_8PageDataERKNS0_4LineERNS1_11BidiScratchEi)
    *librayopdf_pdf.a:document.cpp.o(.text._ZNSt8__detail9_Map_baseIjSt4pairIKjSt10unique_ptrIN7RayoPdf8Document4Impl12ObjectStreamESt14default_deleteIS7_EEESaISB_ENS_10_Select1stESt8equal_toIjESt4hashIjENS_18_Mod_range_hashingENS_20_Default_ranged_hashENS_20_Prime_rehash_policyENS_17_Hashtable_traitsILb0ELb0ELb1EEELb1EEixERS2_)
    *librayopdf_pdf.a:document.cpp.o(.text._ZN7RayoPdf8Document4Impl16LoadObjectStreamEj)
    *librayopdf_pdf.a:document.cpp.o(.text._ZN7RayoPdf8Document4Impl16FillObjectStreamEjRNS1_12ObjectStreamE)
    *libstdc++.a:string-inst.o(.text._ZNSt7__cxx1112basic_stringIcSt11char_traitsIcESaIcEE10_M_disposeEv)
    *librayopdf_layout.a:interpreter.cpp.o(.text._ZN7RayoPdf6Layout12_GLOBAL__N_111Interpreter18PlaceGlyphsGeneralESt17basic_string_viewIcSt11char_traitsIcEERKNS1_9PlacementEdd)
    *librayopdf_layout.a:reading_order.cpp.o(.text._ZSt16__insertion_sortIN9__gnu_cxx17__normal_iteratorIPjSt6vectorIjSaIjEEEENS0_5__ops15_Iter_comp_iterIZN7RayoPdf6Layout12_GLOBAL__N_17Orderer12SplitAtRulesERS5_RS3_ImSaImEEEUljjE_EEEvT_SJ_T0_)
    *librayopdf_layout.a:reading_order.cpp.o(.text._ZSt16__introsort_loopIN9__gnu_cxx17__normal_iteratorIPjSt6vectorIjSaIjEEEElNS0_5__ops15_Iter_comp_iterIZN7RayoPdf6Layout12_GLOBAL__N_17Orderer12SplitAtRulesERS5_RS3_ImSaImEEEUljjE_EEEvT_SJ_T0_T1_)
    *librayopdf_layout.a:semantics.cpp.o(.text._ZNSt8__detail9_Map_baseIiSt4pairIKiS1_IiiEESaIS4_ENS_10_Select1stESt8equal_toIiESt4hashIiENS_18_Mod_range_hashingENS_20_Default_ranged_hashENS_20_Prime_rehash_policyENS_17_Hashtable_traitsILb0ELb0ELb1EEELb1EEixEOi)
    *librayopdf_layout.a:tables.cpp.o(.text._ZSt25__unguarded_linear_insertIN9__gnu_cxx17__normal_iteratorIPN7RayoPdf6Layout12_GLOBAL__N_14EdgeESt6vectorIS5_SaIS5_EEEENS0_5__ops14_Val_comp_iterIZNS4_8Detector10RuleStacksEvEUlRKS5_SF_E0_EEEvT_T0_.isra.0)
    *librayopdf_layout.a:tables.cpp.o(.text._ZZN7RayoPdf6Layout12_GLOBAL__N_18Detector10RuleStacksEvENKUlvE1_clEv)
    *librayopdf_layout.a:tables.cpp.o(.text._ZNSt6vectorIhSaIhEE13_M_assign_auxIN9__gnu_cxx17__normal_iteratorIPhS1_EEEEvT_S7_St20forward_iterator_tag.isra.0)
    *librayopdf_layout.a:lines.cpp.o(.text._ZN7RayoPdf6Layout12_GLOBAL__N_113InitialLetterERKNS0_8PageDataERKNS0_5GlyphE.isra.0)
    *librayopdf_layout.a:lines.cpp.o(.text._ZNSt6vectorIN7RayoPdf4Text4Bidi5ClassESaIS3_EE17_M_default_appendEm)
    *librayopdf_text.a:bidi.cpp.o(.text._ZN7RayoPdf4Text4Bidi7ClassOfEj)
    *librayopdf_text.a:bidi.cpp.o(.text._ZN7RayoPdf4Text4Bidi15VisualToLogicalEPKNS1_5ClassEPKjmRSt6vectorIjSaIjEEPS7_IhSaIhEEi)
    *libc.a:munmap.o(.text)
    *librayopdf_layout.a:reading_order.cpp.o(.text._ZSt25__unguarded_linear_insertIN9__gnu_cxx17__normal_iteratorIPN7RayoPdf6Layout12_GLOBAL__N_18BandLineESt6vectorIS5_SaIS5_EEEENS0_5__ops14_Val_comp_iterIZNS4_24RemoveCountedPageNumbersERS7_INS3_8PageDataESaISD_EEEUlRKS5_SI_E_EEEvT_T0_)
    *librayopdf_layout.a:reading_order.cpp.o(.text._ZSt16__insertion_sortIN9__gnu_cxx17__normal_iteratorIPN7RayoPdf6Layout12_GLOBAL__N_18BandLineESt6vectorIS5_SaIS5_EEEENS0_5__ops15_Iter_comp_iterIZNS4_24RemoveCountedPageNumbersERS7_INS3_8PageDataESaISD_EEEUlRKS5_SI_E_EEEvT_SL_T0_)
    *librayopdf_layout.a:reading_order.cpp.o(.text._ZSt16__introsort_loopIN9__gnu_cxx17__normal_iteratorIPN7RayoPdf6Layout12_GLOBAL__N_18BandLineESt6vectorIS5_SaIS5_EEEElNS0_5__ops15_Iter_comp_iterIZNS4_24RemoveCountedPageNumbersERS7_INS3_8PageDataESaISD_EEEUlRKS5_SI_E_EEEvT_SL_T0_T1_)
    *librayopdf_layout.a:semantics.cpp.o(.text._ZN7RayoPdf6Layout12_GLOBAL__N_113DivisionLabelESt17basic_string_viewIcSt11char_traitsIcEE)
    *librayopdf_layout.a:tables.cpp.o(.text._ZSt25__unguarded_linear_insertIN9__gnu_cxx17__normal_iteratorIPN7RayoPdf6Layout12_GLOBAL__N_14EdgeESt6vectorIS5_SaIS5_EEEENS0_5__ops14_Val_comp_iterIZNS4_8Detector10RuleStacksEvEUlRKS5_SF_E1_EEEvT_T0_.isra.0)
    *librayopdf_layout.a:tables.cpp.o(.text._ZSt9__find_ifIN9__gnu_cxx17__normal_iteratorIPSt4pairIiiESt6vectorIS3_SaIS3_EEEENS0_5__ops16_Iter_equals_valIKS3_EEET_SD_SD_T0_St26random_access_iterator_tag.isra.0)
    *librayopdf_layout.a:tables.cpp.o(.text._ZSt16__introsort_loopIN9__gnu_cxx17__normal_iteratorIPjSt6vectorIjSaIjEEEElNS0_5__ops15_Iter_comp_iterIZN7RayoPdf6Layout12_GLOBAL__N_18Detector8BoxGridsEvEUljjE_EEEvT_SF_T0_T1_)
    *librayopdf_layout.a:tables.cpp.o(.text._ZSt16__introsort_loopIN9__gnu_cxx17__normal_iteratorIPjSt6vectorIjSaIjEEEElNS0_5__ops15_Iter_comp_iterIZN7RayoPdf6Layout12_GLOBAL__N_18Detector8BoxGridsEvEUljjE0_EEEvT_SF_T0_T1_)
    *librayopdf_layout.a:tables.cpp.o(.text._ZSt16__introsort_loopIN9__gnu_cxx17__normal_iteratorIPjSt6vectorIjSaIjEEEElNS0_5__ops15_Iter_comp_iterIZN7RayoPdf6Layout12_GLOBAL__N_18Detector8BoxGridsEvEUljjE1_EEEvT_SF_T0_T1_)
    *librayopdf_layout.a:tables.cpp.o(.text._ZSt16__introsort_loopIN9__gnu_cxx17__normal_iteratorIPjSt6vectorIjSaIjEEEElNS0_5__ops15_Iter_comp_iterIZN7RayoPdf6Layout12_GLOBAL__N_18Detector8BoxGridsEvEUljjE2_EEEvT_SF_T0_T1_)
    *librayopdf_layout.a:tables.cpp.o(.text._ZN7RayoPdf6Layout12_GLOBAL__N_110PageNumberESt17basic_string_viewIcSt11char_traitsIcEE)
    *librayopdf_layout.a:tables.cpp.o(.text._ZSt16__insertion_sortIN9__gnu_cxx17__normal_iteratorIPjSt6vectorIjSaIjEEEENS0_5__ops15_Iter_comp_iterIZN7RayoPdf6Layout12_GLOBAL__N_18Detector8BoxGridsEvEUljjE_EEEvT_SF_T0_)
    *librayopdf_layout.a:tables.cpp.o(.text._ZSt16__insertion_sortIN9__gnu_cxx17__normal_iteratorIPjSt6vectorIjSaIjEEEENS0_5__ops15_Iter_comp_iterIZN7RayoPdf6Layout12_GLOBAL__N_18Detector8BoxGridsEvEUljjE1_EEEvT_SF_T0_)
    *librayopdf_layout.a:tables.cpp.o(.text._ZSt16__insertion_sortIN9__gnu_cxx17__normal_iteratorIPjSt6vectorIjSaIjEEEENS0_5__ops15_Iter_comp_iterIZN7RayoPdf6Layout12_GLOBAL__N_18Detector8BoxGridsEvEUljjE0_EEEvT_SF_T0_)
    *librayopdf_layout.a:tables.cpp.o(.text._ZSt16__insertion_sortIN9__gnu_cxx17__normal_iteratorIPjSt6vectorIjSaIjEEEENS0_5__ops15_Iter_comp_iterIZN7RayoPdf6Layout12_GLOBAL__N_18Detector8BoxGridsEvEUljjE2_EEEvT_SF_T0_)
    *librayopdf_layout.a:tables.cpp.o(.text._ZZN7RayoPdf6Layout12_GLOBAL__N_18Detector8BoxGridsEvENKUlRSt6vectorIZNS2_8BoxGridsEvE4BandSaIS4_EEiffE_clES7_iff.isra.0)
    *librayopdf_layout.a:tables.cpp.o(.text._ZNSt6vectorIjSaIjEED2Ev)
    *librayopdf_layout.a:tables.cpp.o(.text._ZNSt6vectorIhSaIhEED2Ev)
    *librayopdf_layout.a:tables.cpp.o(.text._ZNSt6vectorIfSaIfEED2Ev)
    *librayopdf_layout.a:tables.cpp.o(.text._ZNSt6vectorIhSaIhEEC2EmRKhRKS0_)
    *librayopdf_layout.a:figures.cpp.o(.text._ZN7RayoPdf6Layout12_GLOBAL__N_18NextCellEPKmiib)
    *librayopdf_layout.a:figures.cpp.o(.text._ZNSt6vectorIN7RayoPdf6Layout13FigureStrokes7ClusterESaIS3_EE17_M_realloc_insertIJS3_EEEvN9__gnu_cxx17__normal_iteratorIPS3_S5_EEDpOT_)
    *librayopdf_layout.a:figures.cpp.o(.text._ZNSt6vectorIN7RayoPdf6Layout13FigureStrokes5CurveESaIS3_EE17_M_realloc_insertIJS3_EEEvN9__gnu_cxx17__normal_iteratorIPS3_S5_EEDpOT_)
    *librayopdf_layout.a:markdown_writer.cpp.o(.text._ZN7RayoPdf6Layout12_GLOBAL__N_110WordLetterESt17basic_string_viewIcSt11char_traitsIcEE)
    *librayopdf_text.a:font.cpp.o(.text._ZN7RayoPdf4Text4Font4Impl8CompleteEv)
    *librayopdf_text.a:font.cpp.o(.text._ZN7RayoPdf4Text4Font4Impl12CompleteOnceEv)
    *librayopdf_text.a:font.cpp.o(.text._ZNK7RayoPdf4Text4Font4Impl10NextSimpleESt17basic_string_viewIcSt11char_traitsIcEERmRNS0_4CodeE)
    *librayopdf_text.a:tables.cpp.o(.text._ZN7RayoPdf4Text6Tables13FindGlyphNameESt17basic_string_viewIcSt11char_traitsIcEE)
    *librayopdf_text.a:tables.cpp.o(.text._ZN7RayoPdf4Text18GlyphNameToUnicodeESt17basic_string_viewIcSt11char_traitsIcEEbRNSt7__cxx1112basic_stringIcS3_SaIcEEE)
    *libstdc++.a:string-inst.o(.text._ZNKSt7__cxx1112basic_stringIcSt11char_traitsIcESaIcEE17find_first_not_ofEcm)
    *librayopdf_layout.a:interpreter.cpp.o(.text._ZN7RayoPdf6Layout12_GLOBAL__N_111Interpreter11InlineImageERKNS_8PdfValueES5_St17basic_string_viewIcSt11char_traitsIcEE)
    *librayopdf_layout.a:ocr_layer.cpp.o(.text._ZSt20get_temporary_bufferIjESt4pairIPT_lEl)
    *librayopdf_layout.a:reading_order.cpp.o(.text._ZSt16__insertion_sortIN9__gnu_cxx17__normal_iteratorIPjSt6vectorIjSaIjEEEENS0_5__ops15_Iter_comp_iterIZN7RayoPdf6Layout12_GLOBAL__N_17Orderer11TopologicalERKS5_EUljjE_EEEvT_SH_T0_)
    *librayopdf_layout.a:reading_order.cpp.o(.text._ZSt16__introsort_loopIN9__gnu_cxx17__normal_iteratorIPjSt6vectorIjSaIjEEEElNS0_5__ops15_Iter_comp_iterIZN7RayoPdf6Layout12_GLOBAL__N_17Orderer11TopologicalERKS5_EUljjE_EEEvT_SH_T0_T1_)
    *librayopdf_layout.a:semantics.cpp.o(.text._ZSt13__adjust_heapIN9__gnu_cxx17__normal_iteratorIPjSt6vectorIjSaIjEEEEljNS0_5__ops15_Iter_comp_iterIZN7RayoPdf6Layout11BuildBlocksERKS3_INSA_8PageDataESaISB_EERKS3_INSA_12OutlineEntryESaISG_EERKS3_IhSaIhEEbRNSA_9BlockListEEUljjE_EEEvT_T0_SU_T1_T2_)
    *librayopdf_layout.a:semantics.cpp.o(.text._ZNSt3_V28__rotateIN9__gnu_cxx17__normal_iteratorIPhSt6vectorIhSaIhEEEEEET_S8_S8_S8_St26random_access_iterator_tag.isra.0)
    *librayopdf_layout.a:semantics.cpp.o(.text._ZNSt3_V28__rotateIN9__gnu_cxx17__normal_iteratorIPN7RayoPdf6Layout9BlockLineESt6vectorIS5_SaIS5_EEEEEET_SB_SB_SB_St26random_access_iterator_tag.isra.0)
    *librayopdf_layout.a:semantics.cpp.o(.text._ZSt16__introsort_loopIPjlN9__gnu_cxx5__ops15_Iter_less_iterEEvT_S4_T0_T1_.isra.0)
    *librayopdf_layout.a:semantics.cpp.o(.text._ZSt16__introsort_loopIN9__gnu_cxx17__normal_iteratorIPN7RayoPdf6Layout12_GLOBAL__N_15Marks6HeightESt6vectorIS6_SaIS6_EEEElNS0_5__ops15_Iter_comp_iterIZNS4_10IndexMarksERS5_EUlRKS6_SG_E_EEEvT_SJ_T0_T1_)
    *librayopdf_layout.a:semantics.cpp.o(.text._ZNSt3_V28__rotateIN9__gnu_cxx17__normal_iteratorIPN7RayoPdf6Layout5BlockESt6vectorIS5_SaIS5_EEEEEET_SB_SB_SB_St26random_access_iterator_tag.isra.0)
    *librayopdf_layout.a:semantics.cpp.o(.text._ZSt16__insertion_sortIN9__gnu_cxx17__normal_iteratorIPN7RayoPdf6Layout12_GLOBAL__N_15Marks6HeightESt6vectorIS6_SaIS6_EEEENS0_5__ops15_Iter_comp_iterIZNS4_10IndexMarksERS5_EUlRKS6_SG_E_EEEvT_SJ_T0_.isra.0)
    *librayopdf_layout.a:semantics.cpp.o(.text._ZSt16__insertion_sortIPjN9__gnu_cxx5__ops15_Iter_less_iterEEvT_S4_T0_.isra.0)
    *librayopdf_layout.a:semantics.cpp.o(.text._ZNSt3_V28__rotateIN9__gnu_cxx17__normal_iteratorIPjSt6vectorIjSaIjEEEEEET_S8_S8_S8_St26random_access_iterator_tag.isra.0)
    *librayopdf_layout.a:structure.cpp.o(.text._ZSt13__adjust_heapIN9__gnu_cxx17__normal_iteratorIPZN7RayoPdf6Layout12TaggedLayout12LayOutTablesERNS3_8PageDataEjE5EntrySt6vectorIS7_SaIS7_EEEElS7_NS0_5__ops15_Iter_comp_iterIZNS4_12LayOutTablesES6_jEUlRKS7_SG_E_EEEvT_T0_SK_T1_T2_)
    *librayopdf_layout.a:structure.cpp.o(.text._ZSt13__adjust_heapIN9__gnu_cxx17__normal_iteratorIPN7RayoPdf6Layout10StructItemESt6vectorIS4_SaIS4_EEEElS4_NS0_5__ops15_Iter_comp_iterIZNS3_12_GLOBAL__N_16Reader3RunEvEUlRKS4_SF_E_EEEvT_T0_SJ_T1_T2_)
    *librayopdf_layout.a:structure.cpp.o(.text._ZN7RayoPdf6Layout12_GLOBAL__N_16Reader10AppendTextERKNS_8PdfValueERjS6_)
    *librayopdf_layout.a:structure.cpp.o(.text._ZNKSt10_HashtableISt17basic_string_viewIcSt11char_traitsIcEESt4pairIKS3_S4_IN7RayoPdf6Layout10StructRoleEhEESaISA_ENSt8__detail10_Select1stESt8equal_toIS3_ESt4hashIS3_ENSC_18_Mod_range_hashingENSC_20_Default_ranged_hashENSC_20_Prime_rehash_policyENSC_17_Hashtable_traitsILb1ELb0ELb1EEEE19_M_find_before_nodeEmRS5_m)
    *librayopdf_layout.a:tables.cpp.o(.text._ZSt16__insertion_sortIN9__gnu_cxx17__normal_iteratorIPN7RayoPdf6Layout12_GLOBAL__N_13GapESt6vectorIS5_SaIS5_EEEENS0_5__ops15_Iter_comp_iterIZNS4_8Detector8TextGridERKS7_INS4_3RowESaISE_EERKS7_IjSaIjEEmmRKS9_NS3_9TableKindEtffPKS7_IhSaIhEEST_PKS7_INS4_4EdgeESaISU_EEPKS7_IfSaIfEEEUlRKS5_S14_E_EEEvT_S17_T0_.isra.0)
    *librayopdf_layout.a:tables.cpp.o(.text._ZSt16__introsort_loopIN9__gnu_cxx17__normal_iteratorIPN7RayoPdf6Layout12_GLOBAL__N_13GapESt6vectorIS5_SaIS5_EEEElNS0_5__ops15_Iter_comp_iterIZNS4_8Detector8TextGridERKS7_INS4_3RowESaISE_EERKS7_IjSaIjEEmmRKS9_NS3_9TableKindEtffPKS7_IhSaIhEEST_PKS7_INS4_4EdgeESaISU_EEPKS7_IfSaIfEEEUlRKS5_S14_E_EEEvT_S17_T0_T1_)
    *librayopdf_layout.a:tables.cpp.o(.text._ZNSt6vectorIN7RayoPdf6Layout12_GLOBAL__N_14GridESaIS3_EE8_M_eraseEN9__gnu_cxx17__normal_iteratorIPS3_S5_EE)
    *librayopdf_layout.a:tables.cpp.o(.text._ZSt11__remove_ifIN9__gnu_cxx17__normal_iteratorIPN7RayoPdf6Layout12_GLOBAL__N_13GapESt6vectorIS5_SaIS5_EEEENS0_5__ops10_Iter_predIZZNS4_8Detector10RuleStacksEvENKUlPKNS4_3InkEmmfRS9_PKS7_IhSaIhEEE_clESG_mmfSH_SL_EUlRKS5_E_EEET_SR_SR_T0_)
    *librayopdf_layout.a:tables.cpp.o(.text._ZNSt6vectorIhSaIhEE14_M_fill_insertEN9__gnu_cxx17__normal_iteratorIPhS1_EEmRKh)
    *librayopdf_layout.a:tables.cpp.o(.text._ZNSt6vectorIfSaIfEE14_M_insert_rvalEN9__gnu_cxx17__normal_iteratorIPKfS1_EEOf)
    *librayopdf_layout.a:lines.cpp.o(.text._ZN7RayoPdf6Layout12_GLOBAL__N_113SpacingAccentESt17basic_string_viewIcSt11char_traitsIcEE)
    *librayopdf_layout.a:lines.cpp.o(.text._ZN7RayoPdf6Layout12_GLOBAL__N_17MeasureERKNS0_8PageDataERNS0_4LineE)
    *librayopdf_layout.a:lines.cpp.o(.text._ZN7RayoPdf6Layout12_GLOBAL__N_110AccentSitsERKNS0_5GlyphES4_ifRf)
    *librayopdf_layout.a:lines.cpp.o(.text._ZSt13__lower_boundIN9__gnu_cxx17__normal_iteratorIPKjSt6vectorIjSaIjEEEEjNS0_5__ops14_Iter_less_valEET_SA_SA_RKT0_T1_.isra.0)
    *librayopdf_layout.a:lines.cpp.o(.text._ZSt16__insertion_sortIN9__gnu_cxx17__normal_iteratorIPjSt6vectorIjSaIjEEEENS0_5__ops15_Iter_comp_iterIZN7RayoPdf6Layout12_GLOBAL__N_111PlaceGlyphsINSB_12FiniteMinMaxEEEvRNSA_8PageDataERS5_bRKS5_EUljjE1_EEEvT_SL_T0_)
    *librayopdf_layout.a:lines.cpp.o(.text._ZSt24__merge_sort_with_bufferIN9__gnu_cxx17__normal_iteratorIPjSt6vectorIjSaIjEEEES2_NS0_5__ops15_Iter_comp_iterIZN7RayoPdf6Layout12_GLOBAL__N_111PlaceGlyphsINSB_12FiniteMinMaxEEEvRNSA_8PageDataERS5_bRKS5_EUljjE1_EEEvT_SL_T0_T1_)
    *librayopdf_layout.a:lines.cpp.o(.text._ZN7RayoPdf6Layout12_GLOBAL__N_111GlyphAccentERKNS0_8PageDataERKNS0_5GlyphE)
    *librayopdf_layout.a:lines.cpp.o(.text._ZSt16__merge_adaptiveIN9__gnu_cxx17__normal_iteratorIPjSt6vectorIjSaIjEEEElS2_NS0_5__ops15_Iter_comp_iterIZN7RayoPdf6Layout12_GLOBAL__N_111PlaceGlyphsINSB_12FiniteMinMaxEEEvRNSA_8PageDataERS5_bRKS5_EUljjE1_EEEvT_SL_SL_T0_SM_T1_T2_)
    *librayopdf_layout.a:lines.cpp.o(.text._ZSt22__stable_sort_adaptiveIN9__gnu_cxx17__normal_iteratorIPjSt6vectorIjSaIjEEEES2_NS0_5__ops15_Iter_comp_iterIZN7RayoPdf6Layout12_GLOBAL__N_111PlaceGlyphsINSB_12FiniteMinMaxEEEvRNSA_8PageDataERS5_bRKS5_EUljjE1_EEEvT_SL_SL_T0_T1_)
    *librayopdf_layout.a:lines.cpp.o(.text._ZN7RayoPdf6Layout12_GLOBAL__N_110AccentOverERKNS0_8PageDataERKNS0_5GlyphES7_iRf.constprop.0)
    *librayopdf_layout.a:lines.cpp.o(.text._ZN7RayoPdf6Layout12_GLOBAL__N_112DroppedSpaceERKNS0_8PageDataERKNS0_5GlyphES7_ffffPKjS9_PNS1_9SpaceFontERi)
    *librayopdf_layout.a:lines.cpp.o(.text._ZN7RayoPdf6Layout12_GLOBAL__N_111SeatAccentsERNS0_8PageDataEPKjS5_bRSt6vectorIjSaIjEEbRj.constprop.0)
    *librayopdf_layout.a:lines.cpp.o(.text._ZN7RayoPdf6Layout12_GLOBAL__N_17SplitAtERNS0_8PageDataEmj)
    *librayopdf_layout.a:lines.cpp.o(.text._ZNSt6vectorIS_IjSaIjEESaIS1_EE17_M_realloc_insertIJEEEvN9__gnu_cxx17__normal_iteratorIPS1_S3_EEDpOT_)
    *librayopdf_layout.a:markdown_writer.cpp.o(.text._ZN7RayoPdf6Layout12_GLOBAL__N_18PairHashERKNS0_8PageDataEmRm)
    *librayopdf_text.a:tables.cpp.o(.text._ZN7RayoPdf4Text12_GLOBAL__N_18ParseHexESt17basic_string_viewIcSt11char_traitsIcEERj.constprop.0)
    *librayopdf_pdf.a:content_lexer.cpp.o(.text._ZNSt6vectorIN7RayoPdf12PdfDictEntryESaIS1_EE17_M_realloc_insertIJS1_EEEvN9__gnu_cxx17__normal_iteratorIPS1_S3_EEDpOT_)
    *librayopdf_pdf.a:content_lexer.cpp.o(.text._ZN7RayoPdf12ContentLexer15ReadInlineImageEv)
    *libm-*.a:s_roundf.o(.text)
    *libc.a:pthread_mutex_cond_lock.o(.text)
  }
}
INSERT BEFORE .text;
